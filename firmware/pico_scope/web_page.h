#pragma once

// Generated by web/embed_web.ps1. Edit the source files in web/.
const char WEB_PAGE[] = R"HTML(
<!doctype html>
<html lang="en">
<head>
  <meta charset="utf-8">
  <meta name="viewport" content="width=device-width,initial-scale=1,viewport-fit=cover">
  <meta name="theme-color" content="#07101a">
  <meta name="description" content="A six-channel FPGA oscilloscope interface for the Terasic DE10-Lite and Raspberry Pi Pico W.">
  <title>FPGA Oscilloscope</title>
  <style>
:root {
  color-scheme: dark;
  --bg: #05080e;
  --panel: #0b111b;
  --panel2: #101a28;
  --line: #25364a;
  --text: #e5edf5;
  --muted: #8495a9;
  --cyan: #35e5ff;
  --green: #4dff9a;
  --amber: #ffc857;
  --red: #ff6474;
  --blue: #5d8dff;
}

* { box-sizing: border-box; }

body {
  margin: 0;
  min-height: 100vh;
  background: var(--bg);
  color: var(--text);
  font: 14px/1.45 Inter, ui-sans-serif, system-ui, sans-serif;
}

button, input, select { font: inherit; }
button, select, input[type="checkbox"], input[type="range"] { cursor: pointer; }
button:disabled { cursor: not-allowed; opacity: .48; }
select:disabled { cursor: wait; opacity: .6; }
:focus-visible { outline: 2px solid var(--cyan); outline-offset: 2px; }

.shell {
  width: min(1220px, 100%);
  margin: 0 auto;
  padding: 18px;
}

header {
  display: flex;
  align-items: center;
  justify-content: space-between;
  gap: 16px;
  margin-bottom: 14px;
}

.brand { display: flex; align-items: center; gap: 12px; }
.mark {
  width: 42px; height: 42px; border: 1px solid #327695;
  border-radius: 10px; position: relative; background: #091522;
}
.mark::after {
  content: ""; position: absolute; inset: 9px 6px;
  background: linear-gradient(135deg, transparent 0 17%, var(--cyan) 18% 22%, transparent 23% 39%, var(--cyan) 40% 45%, transparent 46% 61%, var(--cyan) 62% 67%, transparent 68%);
}
h1 { margin: 0; font-size: clamp(20px, 4vw, 30px); letter-spacing: .035em; }
.eyebrow { color: var(--cyan); font: 700 11px/1 monospace; letter-spacing: .18em; text-transform: uppercase; }

.status-row { display: flex; flex-wrap: wrap; justify-content: flex-end; gap: 7px; }
.pill {
  display: inline-flex; align-items: center; gap: 7px;
  min-height: 30px; padding: 5px 10px; border: 1px solid var(--line);
  border-radius: 999px; background: #0b121c; color: var(--muted);
  font: 600 12px/1 monospace; white-space:nowrap; flex-shrink:0;
}
.rate-pill { min-width:82px; justify-content:center; font-variant-numeric:tabular-nums; }
.graph-source { display:flex; align-items:center; gap:12px; justify-content:space-between; padding:8px 12px; border-bottom:1px solid var(--line); }
.graph-source .mode-button { min-height:36px; padding:6px 9px; font-size:12px; }
.graph-source > span { color:var(--muted); font-size:11px; text-align:right; }
.graph-source[hidden] { display:none; }
.dot { width: 7px; height: 7px; border-radius: 50%; background: var(--amber); }
.pill > span { min-width:0; overflow:hidden; text-overflow:ellipsis; }
.pill .dot { flex-shrink:0; }
.ok .dot { background: var(--green); }
.bad .dot { background: var(--red); }

.layout { display: grid; grid-template-columns: minmax(0, 1fr) 300px; gap: 14px; }
.panel { border: 1px solid var(--line); border-radius: 8px; background: var(--panel); }

.scope-panel { overflow: hidden; }
.scope-toolbar {
  display: flex; flex-wrap: wrap; align-items: center; justify-content: space-between;
  gap: 10px; padding: 10px 12px; border-bottom: 1px solid var(--line);
  background: var(--panel2);
}
.scope-title { display: flex; align-items: center; gap: 10px; font: 700 12px monospace; letter-spacing: .08em; }
.run-badge { padding: 3px 8px; border-radius: 4px; color: #03120a; background: var(--green); }

.run-badge.paused { color: #261800; background: var(--amber); }
.mode-switch { display: flex; gap: 4px; padding: 3px; border: 1px solid var(--line); border-radius: 8px; background: #07101a; }
.mode-button { min-height: 30px; padding: 4px 8px; border: 0; background: transparent; color: var(--muted); font: 700 11px monospace; }
.mode-button:hover { background: #132236; }
.mode-button.active { background: #0a5667; color: white; }
.toolbar-controls { display: grid; grid-template-columns: minmax(180px,1fr) minmax(170px,1fr); gap: 10px; width:100%; }
.toolbar-field { display:grid; gap:3px; color:var(--muted); font:700 9px monospace; letter-spacing:.08em; }
.toolbar-field > span:first-child { display:flex; justify-content:space-between; gap:10px; padding-inline:3px; }
.toolbar-field b { color:var(--cyan); font-weight:700; letter-spacing:0; white-space:nowrap; }
.vga-scale-field, .voltage-scale-field { min-width:0; }
.toolbar-field select { width:100%; min-width:0; align-self:start; }
.toolbar-controls > button { min-height:38px; }
.vga-scale-field > small { max-width:245px; color:var(--cyan); font:9px/1.25 monospace; letter-spacing:0; }
.scale-slider { min-height:24px; height:24px; padding:0; border:0; background:transparent; accent-color:var(--cyan); }
.slider-ends { display:flex; justify-content:space-between; padding:0 2px !important; color:var(--muted); font:8px/1 monospace; letter-spacing:0; }

select, input {
  width: 100%; min-height: 38px; border: 1px solid #30445c; border-radius: 8px;
  background: #07101a; color: var(--text); padding: 7px 9px; outline: none;
}
select:focus, input:focus { border-color: var(--cyan); box-shadow: 0 0 0 2px #35e5ff20; }
.compact { width: auto; min-height: 32px; padding: 4px 8px; font: 12px monospace; }

button {
  min-height: 36px; border: 1px solid #35506b; border-radius: 8px;
  padding: 7px 11px; color: var(--text); background: #132236; cursor: pointer;
}
button:hover { border-color: var(--cyan); background: #17304a; }
button:disabled { opacity: .5; cursor: wait; }
button.primary { border-color: #1b8ea2; background: #0a5667; color: white; font-weight: 700; }
button.danger { border-color: #713744; background: #32151c; }

.canvas-wrap { position: relative; min-height: 410px; background: #03070b; }
canvas { display: block; width: 100%; height: 410px; touch-action: none; }
.readout {
  position: absolute; top: 10px; left: 12px; pointer-events: none;
  color: var(--cyan);
  font: 700 clamp(16px, 3vw, 25px)/1.1 ui-monospace, monospace;
}
.readout small { display: block; margin-top: 4px; color: var(--muted); font: 11px monospace; text-shadow: none; }
.trigger-label { position: absolute; right: 10px; top: 10px; color: var(--amber); font: 11px monospace; }
.capture-cursor-readout { position: absolute; right: 10px; top: 31px; max-width: calc(100% - 20px); color: var(--cyan); font: 11px monospace; text-align: right; text-shadow: 0 0 8px #000; }
.x-axis-readout { position: absolute; left: 50%; bottom: 29px; transform: translateX(-50%); color: #91a8bb; font: 10px ui-monospace, monospace; white-space: nowrap; text-shadow: 0 0 8px #000; pointer-events: none; }
.snapshot-controls { margin-top: 12px; }

.measurements {
  display: grid; grid-template-columns: repeat(4, 1fr); border-top: 1px solid var(--line);
}
.measurement { min-width: 0; padding: 11px; border-right: 1px solid var(--line); }
.measurement:last-child { border-right: 0; }
.measurement span { display: block; color: var(--muted); font: 10px monospace; letter-spacing: .1em; text-transform: uppercase; }
.measurement strong { display: block; margin-top: 3px; overflow: hidden; color: var(--green); font: 700 17px monospace; text-overflow: ellipsis; }
.measurement-source { padding: 7px 11px; border-top: 1px solid var(--line); color: var(--muted); font: 11px monospace; }

.channel-analysis { border-top: 1px solid var(--line); background: #07101a; }
.channel-analysis-heading { display:flex; align-items:center; justify-content:space-between; gap:12px; padding:10px 12px 7px; }
.channel-analysis-heading h2 { margin:0; color:var(--cyan); font:700 11px monospace; letter-spacing:.1em; text-transform:uppercase; }
.channel-analysis-heading span { color:var(--muted); font:10px monospace; }
.analysis-scroll { overflow-x:auto; overscroll-behavior-inline:contain; }
.channel-analysis table { width:100%; min-width:650px; border-collapse:collapse; font:11px ui-monospace,monospace; }
.channel-analysis th, .channel-analysis td { padding:7px 10px; border-top:1px solid #172738; text-align:right; white-space:nowrap; }
.channel-analysis th { color:var(--muted); font-size:9px; letter-spacing:.06em; text-transform:uppercase; }
.channel-analysis th:first-child, .channel-analysis td:first-child { position:sticky; left:0; z-index:1; text-align:left; background:#07101a; }
.channel-analysis tr.focus td { background-color:#0d1d2a; }
.channel-analysis tr.focus td:first-child { background:#0d1d2a; }
.channel-key { display:inline-flex; align-items:center; gap:6px; color:var(--channel); font-weight:700; }
.channel-key::before { content:""; width:8px; height:8px; border-radius:50%; background:var(--channel); }
.focus-tag { margin-left:5px; color:var(--muted); font-size:9px; }

aside { display: grid; align-content: start; gap: 14px; }
.section { padding: 14px; }
.section h2 { margin: 0 0 12px; color: var(--cyan); font: 700 12px monospace; letter-spacing: .12em; text-transform: uppercase; }
.field { margin-bottom: 11px; }
.field:has(> input[type="checkbox"]) { display:flex; align-items:center; justify-content:space-between; gap:12px; }
.field:has(> input[type="checkbox"]) label { margin:0; }
.field:has(> input[type="checkbox"]) label b { display:none; }
.field > input[type="checkbox"] { width:20px; height:20px; min-height:20px; margin:0; accent-color:var(--cyan); }
.field label { display: flex; justify-content: space-between; margin-bottom: 5px; color: var(--muted); font: 12px monospace; }
.field label b { color: var(--text); font-weight: 600; }
.frequency-entry { display:grid; grid-template-columns:minmax(0,1fr) 78px; gap:6px; }
.compact-status { margin-bottom:12px; }
.two { display: grid; grid-template-columns: 1fr 1fr; gap: 8px; }
.button-row { display: grid; grid-template-columns: 1fr 1fr; gap: 8px; margin-top: 10px; }
.button-row .wide { grid-column: 1 / -1; }
.muted { color: var(--muted); font-size: 12px; margin: -3px 0 12px; }
.command-status { min-height: 36px; margin-top: 10px; padding: 8px; border-radius: 7px; background: #07101a; color: var(--muted); font: 11px/1.5 monospace; }
.command-status.good { color: var(--green); }
.field label span, .field label b, button { overflow-wrap:anywhere; }
.command-status.error { color: var(--red); }
.muted.good { color: var(--green); }
.muted.error { color: var(--red); }
.capture-actions { margin-top: 0; }
.capture-meta { margin-top: 12px; }
.capture-panel[data-state="capturing"] #captureStatus { color: var(--amber); }
.capture-panel[data-state="ready"] #captureStatus { color: var(--green); }
.capture-panel[data-state="error"] #captureStatus { color: var(--red); }

.live-data-grid { display: grid; grid-template-columns: 1fr 1fr; gap: 9px; }
.live-data {
  min-width: 0; padding: 12px 8px; border: 1px solid #294056;
  border-radius: 9px; background: #050c14; text-align: center;
}
.live-data span {
  display: block; color: var(--muted); font: 10px monospace;
  letter-spacing: .1em; text-transform: uppercase;
}
.live-data strong {
  display: block; margin-top: 5px; color: var(--green);
  font: 700 25px/1 monospace;
}

.hex-preview { display:grid; grid-template-columns:repeat(3,1fr); gap:7px; margin:0 0 12px; }
.hex-pair { padding:8px 4px; border:1px solid #294056; border-radius:7px; background:#03080d; text-align:center; }
.hex-pair span { display:block; color:var(--muted); font:9px monospace; text-transform:uppercase; }
.hex-pair strong { display:block; margin-top:3px; color:var(--amber); font:700 18px monospace; letter-spacing:.04em; }
.hex-pair.disabled { opacity:.45; }

.channel-picker { display:grid; grid-template-columns:repeat(3,1fr); gap:7px; margin-bottom:11px; }
.scope-channel-picker { margin:0; padding:10px 12px; border-bottom:1px solid var(--line); }
.scope-channel-picker .channel-picker { grid-template-columns:repeat(6,minmax(0,1fr)); margin-bottom:0; }
#enabledLive { font-size:13px; overflow-wrap:anywhere; line-height:1.3; }
.record-details summary { cursor:pointer; color:var(--muted); margin:10px 0; }
.channel-toggle { position:relative; margin:0; cursor:pointer; }
.field label.channel-toggle { display:block; margin:0; }
.channel-toggle input { position:absolute; opacity:0; pointer-events:none; }
.channel-toggle span {
  display:flex; align-items:center; justify-content:center; gap:6px; min-height:42px;
  border:1px solid #30445c; border-radius:8px; background:#07101a;
  width:100%; color:var(--muted); font:700 12px monospace; transition:.15s ease;
}
.channel-toggle span::before { content:""; width:8px; height:8px; border-radius:50%; background:var(--ch); }
.channel-toggle input:checked + span { border-color:var(--ch); color:var(--ch); background:#13202d; box-shadow:inset 0 -3px var(--ch); }
.channel-toggle input:focus-visible + span { outline:2px solid var(--cyan); outline-offset:2px; }
.channel-toggle input:disabled + span { opacity:.6; cursor:not-allowed; }
.scope-channel-picker .focus-label { margin-top:12px; }
.fft-panel { padding:14px 12px; border-top:1px solid var(--line); }
.fft-heading { display:flex; justify-content:space-between; align-items:center; gap:12px; flex-wrap:wrap; }
.fft-heading h2 { margin:0 0 5px; color:var(--cyan); font-size:14px; }
.fft-heading span,.fft-panel .muted { font-size:12px; color:#aebed0; }
.fft-range { display:flex; align-items:center; gap:12px; margin-top:12px; font-size:12px; }
.fft-range select { width:auto; min-width:0; max-width:70%; }
#fftCanvas { display:block; width:100%; height:240px; min-height:0; background:#050b12; border:1px solid var(--line); border-radius:6px; }
.trace-legend { position:absolute; left:54px; right:12px; bottom:47px; display:flex; flex-wrap:wrap; gap:7px; pointer-events:none; }
.trace-chip { padding:3px 7px; border:1px solid currentColor; border-radius:999px; background:#03070bcc; font:700 10px monospace; }

.diag { display: grid; grid-template-columns: 1fr auto; gap: 7px 12px; margin: 0; font: 12px monospace; }
.diag dt { color: var(--muted); }
.diag dd { margin: 0; color: var(--text); text-align: right; }

footer { margin-top: 14px; color: var(--muted); text-align: center; font: 11px monospace; }
.mobile-actions { display:none; }

@media (prefers-reduced-motion: reduce) {
  *, *::before, *::after { scroll-behavior: auto !important; transition-duration: .01ms !important; animation-duration: .01ms !important; }
}

@media (max-width: 900px) {
  .layout { grid-template-columns: 1fr; }
  aside { grid-template-columns: repeat(2, minmax(0,1fr)); }
}
@media (max-width: 650px) {
  .shell { padding: 10px 10px calc(76px + env(safe-area-inset-bottom)); }
  header { align-items: flex-start; flex-direction: column; }
  .status-row { display:grid; grid-template-columns:minmax(0,1fr) minmax(0,1fr) 82px; gap:5px; width:100%; }
  .status-row .pill { padding:5px 7px; font-size:10px; min-width:0; }
  .status-row .rate-pill { min-width:82px; }
  .graph-source { gap:6px; }
  .graph-source > span { max-width:35%; }
  .canvas-wrap, canvas { min-height: min(330px, 58vh); height: min(330px, 58vh); }
  .measurements { grid-template-columns: repeat(2, 1fr); }
  .measurement:nth-child(even) { border-right: 0; }
  .measurement { border-bottom: 1px solid var(--line); }
  aside { grid-template-columns: 1fr; }
  .mode-switch { width: 100%; }
  .mode-button { flex: 1; }
  .toolbar-controls { display:grid; grid-template-columns:1fr 1fr; width:100%; }
  .toolbar-field { min-width:0; }
  .vga-scale-field { grid-column:auto; }
  .toolbar-field > span:first-child { flex-wrap:wrap; gap:3px; }
  .time-select-field .compact { font-size:10px; padding-inline:3px; }
  #totalTime { width:100%; min-width:0; }
  .toolbar-controls button { min-width:0; padding-inline:6px; }
  .toolbar-controls > :is(#autoButton, #pauseButton, #saveImageButton) { display:none; }
  #clearButton { align-self:end; }
  .field label { gap:8px; align-items:flex-start; }
  .field label b { max-width:48%; text-align:right; }
  button, select, input { min-height:44px; }
  .compact { min-height:42px; }
  .readout { font-size:17px; }
  .trace-legend { left:49px; gap:4px; }
  .trace-chip { padding:2px 5px; font-size:9px; }
  .scope-channel-picker .channel-picker { grid-template-columns:repeat(3,minmax(0,1fr)); }
  .mobile-actions {
    position:fixed; z-index:20; left:0; right:0; bottom:0; display:grid;
    grid-template-columns:repeat(4,1fr); gap:6px; padding:9px max(8px,env(safe-area-inset-left)) calc(9px + env(safe-area-inset-bottom)) max(8px,env(safe-area-inset-right));
    border-top:1px solid #35506b; background:#07101aee; box-shadow:0 -8px 28px #000a; backdrop-filter:blur(10px);
  }
  .mobile-actions button { min-width:0; margin:0; padding-inline:4px; font-size:12px; }
}
</style>

</head>
<body>
  <main class="shell">
    <header>
      <div class="brand">
        <div class="mark"></div>
        <div><div class="eyebrow">DE10-Lite + Pico W</div><h1>FPGA Oscilloscope</h1></div>
      </div>
      <div class="status-row">
        <div id="wifiPill" class="pill" role="status" aria-live="polite"><i class="dot"></i><span>Connecting to Pico W</span></div>
        <div id="uartPill" class="pill"><i class="dot"></i><span>Waiting for FPGA</span></div>
        <div class="pill rate-pill"><span id="rateText">0 pkt/s</span></div>
      </div>
    </header>

    <div class="layout">
      <section class="panel scope-panel">
        <div class="scope-toolbar">
          <div class="scope-title"><span id="runBadge" class="run-badge">RUN</span><span>CH<span id="channelTitle">0</span></span></div>
          <div id="viewMode" class="mode-switch" role="tablist" aria-label="Oscilloscope view">
            <button id="liveModeButton" class="mode-button active" role="tab" aria-selected="true">Live scope</button>
            <button id="captureModeButton" class="mode-button" role="tab" aria-selected="false">Saved capture</button>
          </div>
          <div class="toolbar-controls">
            <label class="toolbar-field vga-scale-field" for="timebase"><span>TIME SCALE <b id="vgaTimebaseValue">X1</b></span>
              <input id="timebase" class="scale-slider" type="range" min="0" max="10" step="1" value="0" aria-describedby="vgaWindowActual">
              <span class="slider-ends" aria-hidden="true"><small>Faster</small><small>Slower</small></span>
              <small id="vgaWindowActual">Shared by VGA and phone</small>
            </label>
            <label class="toolbar-field time-select-field" for="totalTime"><span>TOTAL TIME · 10 DIVISIONS</span><select id="totalTime" class="compact" title="Total time across ten divisions; shared by VGA and phone">
              <option value="0">X1</option>
            </select></label>
            <label class="toolbar-field voltage-scale-field" for="vertical"><span>VOLTAGE SCALE <b id="verticalScaleValue">625 mV/div</b></span>
              <input id="vertical" class="scale-slider" type="range" min="0" max="3" step="1" value="0">
              <span class="slider-ends" aria-hidden="true"><small>Wider range</small><small>More detail</small></span>
            </label>
            <label class="toolbar-field voltage-select-field" for="voltsPerDiv"><span>VOLTS / DIVISION</span><select id="voltsPerDiv" class="compact">
              <option value="0">625 mV/div</option><option value="1">312.5 mV/div</option>
              <option value="2">156.25 mV/div</option><option value="3">78.125 mV/div</option>
            </select></label>
            <label class="toolbar-field"><span>TRIGGER</span><select id="triggerMode" class="compact" title="Trigger mode">
              <option value="free">Free run</option><option value="auto" selected>Auto trigger</option><option value="rising">Rising trigger</option>
              <option value="falling">Falling trigger</option>
            </select></label>
            <button id="autoButton" class="primary">Auto setup</button><button id="pauseButton">Pause</button><button id="clearButton">Clear</button><button id="saveImageButton" title="Save or share the current scope view">Save image</button>
          </div>
        </div>
          <div class="field scope-channel-picker">
            <label><span>Compare channels</span><b>tap to show or hide</b></label>
            <div class="channel-picker" role="group" aria-label="Displayed channels">
              <label class="channel-toggle" style="--ch:#53efff"><input class="channel-check" type="checkbox" value="0" checked><span>CH0</span></label>
              <label class="channel-toggle" style="--ch:#ffd166"><input class="channel-check" type="checkbox" value="1"><span>CH1</span></label>
              <label class="channel-toggle" style="--ch:#70e000"><input class="channel-check" type="checkbox" value="2"><span>CH2</span></label>
              <label class="channel-toggle" style="--ch:#ff70a6"><input class="channel-check" type="checkbox" value="3"><span>CH3</span></label>
              <label class="channel-toggle" style="--ch:#9b8cff"><input class="channel-check" type="checkbox" value="4"><span>CH4</span></label>
              <label class="channel-toggle" style="--ch:#ff8c42"><input class="channel-check" type="checkbox" value="5"><span>CH5</span></label>
            </div>
            <label class="focus-label" for="channel"><span>Focus channel</span><b>trigger, measurements + FFT</b></label>
            <select id="channel" aria-label="Focus channel">
              <option value="0">CH0</option><option value="1">CH1</option><option value="2">CH2</option>
              <option value="3">CH3</option><option value="4">CH4</option><option value="5">CH5</option>
            </select>
          </div>
        <div id="phoneSource" class="graph-source">
          <div class="mode-switch" role="group" aria-label="Phone waveform source">
            <button id="snapshotSourceButton" class="mode-button active" aria-pressed="true">VGA snapshot</button>
            <button id="rawSourceButton" class="mode-button" aria-pressed="false">UART live</button>
          </div>
          <span id="phoneSourceHint">Same window as the VGA display</span>
        </div>
        <div class="canvas-wrap">
          <canvas id="scope" role="img" aria-label="Oscilloscope waveform display"></canvas>
          <div class="readout"><span id="voltageText">0.000 V</span><small id="rawText">ADC 0000</small></div>
          <div id="triggerText" class="trigger-label">AUTO</div>
          <div id="captureCursorReadout" class="capture-cursor-readout" hidden></div>
          <div id="xAxisReadout" class="x-axis-readout">Waiting for FPGA timing...</div>
          <div id="traceLegend" class="trace-legend"></div>
        </div>
        <div class="measurements">
          <div class="measurement"><span>Minimum</span><strong id="minText">0.000 V</strong></div>
          <div class="measurement"><span>Maximum</span><strong id="maxText">0.000 V</strong></div>
          <div class="measurement"><span>Peak-Peak</span><strong id="ppText">0.000 V</strong></div>
          <div class="measurement"><span>Average</span><strong id="avgText">0.000 V</strong></div>
          <div class="measurement"><span>RMS</span><strong id="rmsText">0.000 V</strong></div>
          <div class="measurement"><span>Frequency</span><strong id="frequencyText">-- Hz</strong></div>
          <div class="measurement"><span>Period</span><strong id="periodText">-- ms</strong></div>
          <div class="measurement"><span>Duty</span><strong id="dutyText">-- %</strong></div>
        </div>
        <div id="measurementSource" class="measurement-source">Waiting for an FPGA waveform.</div>
        <section class="channel-analysis" aria-labelledby="channelAnalysisTitle">
          <div class="channel-analysis-heading"><h2 id="channelAnalysisTitle">Channel comparison</h2><span>Visible plot window</span></div>
          <div class="analysis-scroll">
            <table>
              <thead><tr><th>Channel</th><th>Now</th><th>Min</th><th>Max</th><th>P-P</th><th>Average</th><th>RMS</th><th>Frequency</th></tr></thead>
              <tbody id="channelAnalysisBody"><tr><td colspan="8">Waiting for samples...</td></tr></tbody>
            </table>
          </div>
        </section>
        <section class="fft-panel" aria-labelledby="fftTitle">
          <div class="fft-heading"><div><h2 id="fftTitle">Frequency spectrum</h2><span>FPGA FFT snapshot · 256 samples · Hann window</span></div>
            <button id="fftButton" class="primary">Capture FPGA FFT</button>
          </div>
          <label class="fft-range" for="fftRange">Frequency range <select id="fftRange"><option value="10000" selected>Up to 10 kHz</option><option value="1000">Up to 1 kHz</option><option value="5000">Up to 5 kHz</option><option value="50000">Up to 50 kHz</option><option value="100000">Up to 100 kHz</option><option value="raw">Full bandwidth</option><option value="vga">VGA time scale</option></select></label>
          <p id="fftStatus" class="command-status" role="status">Capture the focus channel to see its frequency content. VGA keeps running.</p>
          <canvas id="fftCanvas" role="img" aria-label="FPGA FFT frequency spectrum"></canvas>
          <p id="fftDetails" class="muted">A 1 kHz square wave has a main peak at 1 kHz and smaller odd harmonics. Choose 10 kHz to inspect them. Lower ranges improve frequency resolution.</p>
        </section>
      </section>

      <aside>



        <section class="panel section">
          <h2>Channels</h2>
          <div class="live-data-grid compact-status">
            <div class="live-data"><span>Focus</span><strong id="channelLive">CH0</strong></div>
            <div class="live-data"><span>Enabled</span><strong id="enabledLive">CH0</strong></div>
          </div>
          <div class="hex-preview" title="The three voltage pairs shown on the DE10-Lite display">
            <div id="hexCh0" class="hex-pair"><span>HEX5-4 / CH0</span><strong id="previewCh0">--</strong></div>
            <div id="hexCh1" class="hex-pair"><span>HEX3-2 / CH1</span><strong id="previewCh1">--</strong></div>
            <div id="hexCh2" class="hex-pair"><span>HEX1-0 / CH2</span><strong id="previewCh2">--</strong></div>
          </div>

          <button id="applyButton" style="width:100%">Apply comparison</button>
          <div id="commandStatus" class="command-status">Tap channel buttons to show or hide traces. Select the focus channel for triggering, measurements, and FFT.</div>
        </section>

        <section class="panel section">
          <h2>Acquisition</h2>
          <div class="field"><label for="fullScaleMv"><span>ADC full scale</span><b>calibration</b></label><input id="fullScaleMv" type="number" min="1000" max="9999" value="5000" inputmode="numeric"></div>
          <button id="calibrateButton" style="width:100%;margin-bottom:10px">Apply voltage calibration</button>
          <div class="field"><label for="triggerLevel"><span>Trigger level</span><b id="triggerValue">2.500 V</b></label><input id="triggerLevel" type="range" min="0" max="4095" value="2048"></div>
          <div class="field"><label for="verticalPosition"><span>Vertical position</span><b id="positionValue">50%</b></label><input id="verticalPosition" type="range" min="0" max="100" value="50"></div>
          <div class="field"><label for="triggerPosition"><span>Pre-trigger position</span><b>history</b></label><select id="triggerPosition"><option value="0">10%</option><option value="1" selected>25%</option><option value="2">50%</option><option value="3">75%</option></select></div>
          <div class="field"><label for="acquisitionAverage"><span>Acquisition bandwidth</span><b>speed / noise</b></label><select id="acquisitionAverage"><option value="0" selected>Maximum speed - no averaging</option><option value="1">4 samples - light filtering</option><option value="2">16 samples - low noise</option><option value="3">64 samples - strongest filtering</option></select></div>
          <div class="field"><label for="stabilizeWave"><span>Wave stabilization</span><b>adaptive trigger + short hold</b></label><input id="stabilizeWave" type="checkbox"></div>
          <div class="field"><label for="singleShot"><span>Single-shot capture</span><b>ON/OFF</b></label><input id="singleShot" type="checkbox"></div>
          <div class="field"><label for="gridEnable"><span>VGA graticule</span><b>ON/OFF</b></label><input id="gridEnable" type="checkbox" checked></div>
          <div class="button-row"><button id="rearmButton">Re-arm capture</button><button id="exportButton">Export CSV</button><button id="resetViewButton" class="wide">Reset view</button></div>
        </section>

        <section class="panel section capture-panel">
          <h2>Saved capture</h2>
          <p id="captureStatus" class="command-status">Idle</p>
          <div class="button-row capture-actions">
            <button id="armCaptureButton" class="primary">Arm capture</button>
            <button id="stopCaptureButton" class="danger">Stop</button>
            <button id="downloadCaptureButton" class="wide">Download record</button>
            <button id="manualSnapshotButton" class="wide">Capture focus channel</button>
          </div>
          <div class="button-row">
            <button id="exportCaptureButton">Export capture CSV</button>
            <button id="resetCaptureViewButton">Reset zoom</button>
          </div>
          <div class="button-row capture-zoom-actions">
            <button id="captureZoomInButton" aria-label="Zoom into capture">Zoom in</button>
            <button id="captureZoomOutButton" aria-label="Zoom out of capture">Zoom out</button>
          </div>
          <div class="field snapshot-controls">
            <label for="autoSnapshot"><span>Repeat focus capture</span><b>ON/OFF</b></label>
            <input id="autoSnapshot" type="checkbox">
          </div>
          <div class="field"><label for="snapshotInterval"><span>Snapshot refresh</span><b>UART-limited</b></label>
            <select id="snapshotInterval"><option value="750" selected>Fastest</option><option value="5000">5 s pause</option><option value="15000">15 s pause</option></select>
          </div>
          <p id="snapshotStatus" class="muted">Live scope follows all VGA channels. Saved captures use the focus channel.</p>
          <details class="record-details"><summary>Record details</summary>
          <dl class="diag capture-meta">
            <dt>State</dt><dd id="captureStateText">idle</dd>
            <dt>Records</dt><dd id="captureRecordText">--</dd>
            <dt>Sample rate</dt><dd id="captureRateText">--</dd>
            <dt>Duration</dt><dd id="captureDurationText">--</dd>
            <dt>Trigger</dt><dd id="captureTriggerText">--</dd>
            <dt>Trigger setup</dt><dd id="captureTriggerSetupText">--</dd>
            <dt>Averaging</dt><dd id="captureAverageText">--</dd>
            <dt>Config ID</dt><dd id="captureConfigText">--</dd>
            <dt>Quality</dt><dd id="captureQualityText">--</dd>
          </dl>
          </details>
          <p id="captureHelp" class="muted">Save a focus-channel record for closer inspection. Wheel: zoom. Drag: pan. Tap: cursor. Return to Live scope to follow all enabled channels.</p>
        </section>

        <section class="panel section">
          <h2>GPIO Signal Generators</h2>
          <p class="muted">3.3 V outputs; use a common ground.</p>
          <div class="field"><label for="gen1Frequency"><span>Generator 1 · GPIO[28]</span><b>1 Hz–2 MHz</b></label><span class="frequency-entry"><input id="gen1Frequency" type="number" min="0.001" step="any" value="1" inputmode="decimal"><select id="gen1Unit" aria-label="Generator 1 frequency unit"><option value="Hz">Hz</option><option value="kHz" selected>kHz</option><option value="MHz">MHz</option></select></span></div>
          <div class="field"><label for="gen1Duty"><span>GPIO[28] duty cycle</span><b id="gen1DutyValue">50%</b></label><input id="gen1Duty" type="range" min="0" max="100" value="50"></div>
          <div class="field"><label for="gen1Enable"><span>GPIO[28] output</span><b>ON/OFF</b></label><input id="gen1Enable" type="checkbox"></div>
          <button id="gen1Apply" style="width:100%;margin-bottom:12px">Apply GPIO[28]</button>
          <p class="muted" id="gen1Actual">GPIO[28] is OFF</p>
          <div class="field"><label for="gen2Frequency"><span>Generator 2 · GPIO[30]</span><b>1 Hz–2 MHz</b></label><span class="frequency-entry"><input id="gen2Frequency" type="number" min="0.001" step="any" value="1" inputmode="decimal"><select id="gen2Unit" aria-label="Generator 2 frequency unit"><option value="Hz">Hz</option><option value="kHz" selected>kHz</option><option value="MHz">MHz</option></select></span></div>
          <div class="field"><label for="gen2Duty"><span>GPIO[30] duty cycle</span><b id="gen2DutyValue">50%</b></label><input id="gen2Duty" type="range" min="0" max="100" value="50"></div>
          <div class="field"><label for="gen2Enable"><span>GPIO[30] output</span><b>ON/OFF</b></label><input id="gen2Enable" type="checkbox"></div>
          <button id="gen2Apply" style="width:100%">Apply GPIO[30]</button>
          <p class="muted" id="gen2Actual">GPIO[30] is OFF</p>
        </section>

        <section class="panel section">
          <h2>Diagnostics</h2>
          <dl class="diag">
            <dt>Packets</dt><dd id="packetsText">0</dd>
            <dt>FPGA commands</dt><dd id="commandsText">0</dd>
            <dt>UART errors</dt><dd id="errorsText">0</dd>
            <dt>FPGA baud</dt><dd id="baudText">searching</dd>
            <dt>Browser samples</dt><dd id="samplesText">0</dd>
            <dt>Pico uptime</dt><dd id="uptimeText">0 s</dd>
            <dt>Last update</dt><dd id="ageText">never</dd>
          </dl>
        </section>
      </aside>
    </div>
    <nav class="mobile-actions" aria-label="Quick scope actions">
      <button id="mobileRunButton">Pause</button>
      <button id="mobileAutoButton" class="primary">Auto</button>
    <button id="mobileSnapshotButton">Save capture</button>
      <button id="mobileImageButton">Save image</button>
    </nav>
    <footer><span id="footerBaud">Auto 115200 / 9600 baud</span> 8N1 | SW8 selects FPGA speed | calibrated 12-bit ADC</footer>
  </main>

  <script>
/* Pure capture artifact helpers. This file has no DOM or framework dependencies. */
(function (root, factory) {
  const api = factory();
  if (root) root.FpgaOscilloscopeProtocol = api;
  if (typeof module !== "undefined" && module.exports) module.exports = api;
})(typeof globalThis !== "undefined" ? globalThis : this, function () {
  "use strict";

  const HEADER_BYTES = 64;
  const RECORD_BYTES = 6;
  const MAX_RECORDS = 8192;
  const FORMAT_VERSION = 1;
  const ENVELOPE_VERSION = 2;
  const ENVELOPE_RECORD_BYTES = 10;
  const VGA_PLOT_SAMPLES = 576;

  function vgaTimeOptions(samplePeriodCycles) {
    const cycles = Number(samplePeriodCycles);
    if (!Number.isFinite(cycles) || cycles <= 0) return [];
    return Array.from({length: 11}, (_, timebase) => ({
      timebase,
      decimation: 2 ** timebase,
      seconds: cycles * VGA_PLOT_SAMPLES * (2 ** timebase) / 50000000
    }));
  }

  function decodeLiveFrame(input) {
    const bytes = bytesOf(input);
    const metadataOnly=bytes[0]===0xd9;
    if (bytes.length < 34 || (bytes[0] !== 0xd7 && !metadataOnly) || bytes[1] !== 1 ||
        u16(bytes,2) !== bytes.length) throw new Error("Incomplete VGA frame.");
    let crc = 0xffff;
    for (let i=0; i<bytes.length-2; i++) {
      crc ^= bytes[i] << 8;
      for (let bit=0; bit<8; bit++) crc = ((crc << 1) ^ ((crc & 0x8000) ? 0x1021 : 0)) & 0xffff;
    }
    if (crc !== u16(bytes,bytes.length-2)) throw new Error("VGA frame checksum failed.");
    const mask=bytes[4], channels=[];
    for (let ch=0; ch<6; ch++) if (mask & (1<<ch)) channels.push(ch);
    const columns=u16(bytes,18), period=u16(bytes,12)+(bytes[14]<<16);
    if (!mask || mask>63 || !(mask & (1<<bytes[5])) || bytes[5]>5 ||
        columns!==288 || !period || bytes[6]>10 || bytes[7]>3 || bytes[8]>100 ||
        bytes[9]>3 || bytes[10]>3 || u16(bytes,16)<1000 || u16(bytes,16)>9999 ||
        u16(bytes,26)>576 || bytes.length!==(metadataOnly?34:34+columns*(1+6*channels.length)))
      throw new Error("Invalid VGA frame settings.");
    const traces=Array.from({length:6},()=>[]);
    const intervalSeconds=period*(2**bytes[6])/50000000;
    let offset=32;
    for (let column=0; column<(metadataOnly?0:columns); column++) {
      const valid=bytes[offset++];
      for (const ch of channels) {
        const adc=u16(bytes,offset), low=u16(bytes,offset+2), high=u16(bytes,offset+4);
        offset+=6;
        if (!(valid & (1<<ch))) continue;
        if (low>adc || adc>high || high>4095) throw new Error("Invalid VGA waveform column.");
        traces[ch].push({adc,low,high,timeMs:(2*column+0.5)*intervalSeconds*1000});
      }
    }
    return {id:u16(bytes,20)+u16(bytes,22)*65536, mask, focus:bytes[5],
      timebase:bytes[6], scale:bytes[7], position:bytes[8], trigger:bytes[9],
      triggerPosition:bytes[10], averaging:(bytes[11]>>5)&3,
      running:Boolean(bytes[11]&2), singleShot:Boolean(bytes[11]&16),
      grid:Boolean(bytes[11]&1), stabilize:Boolean(bytes[11]&128),
      triggerLevel:u16(bytes,24), manualMode:Boolean(bytes[28]&1),
      samplePeriodCycles:period, fullScaleMv:u16(bytes,16),
      windowMs:576*intervalSeconds*1000, metadataOnly, traces};
  }
  function decodeRawBatch(data,previousClock=null,previousTime=0) {
    const clock=data.clockUs;
    if(!Number.isInteger(clock)||clock<0||clock>0xffffffff||!Array.isArray(data.raw)||data.raw.length>64)
      throw new Error("Invalid UART live batch.");
    const delta=previousClock===null?0:(clock-previousClock)>>>0;
    const reset=previousClock!==null&&delta>10000000;
    const timeMs=reset?0:previousTime+delta/1000;
    const samples=data.raw.map(sample=>{
      if(!Array.isArray(sample)||sample.length!==3||sample.some(value=>!Number.isInteger(value))||
          sample[0]<0||sample[0]>5||sample[1]<0||sample[1]>4095||sample[2]<0||sample[2]>10000000)
        throw new Error("Invalid UART live sample.");
      return {channel:sample[0],adc:sample[1],timeMs:timeMs-sample[2]/1000};
    });
    return {clockUs:clock,timeMs,reset,samples,drops:Number(data.drops)||0};
  }
  const ADC_MAX = 4095;
  function decodeFftFrame(input) {
    const bytes=bytesOf(input);
    if(bytes.length!==550 || bytes[0]!==0xd8 || bytes[1]!==1 || u16(bytes,2)!==550)
      throw new Error("Incomplete FPGA FFT snapshot.");
    let crc=0xffff;
    for(let i=0;i<548;i++){
      crc^=bytes[i]<<8;
      for(let bit=0;bit<8;bit++)crc=((crc<<1)^((crc&0x8000)?0x1021:0))&0xffff;
    }
    if(crc!==u16(bytes,548))throw new Error("FFT checksum failed. Capture again.");
    if(bytes[4]!==1)throw new Error("FPGA FFT acquisition was invalid. Capture again.");
    const id=u32(bytes,8),period=u32(bytes,12),fullScaleMv=u16(bytes,16);
    const elapsedTicks=u32(bytes,20),dcMean=u16(bytes,24),gain=u16(bytes,26)/32768;
    if(!id || id>65535 || bytes[5]>5 || bytes[6]!==8 || bytes[7]>10 || !period ||
        fullScaleMv<1000 || fullScaleMv>9999 || u16(bytes,18)!==256 ||
        !elapsedTicks || Math.abs(elapsedTicks-period*255)>127 || dcMean>4095 ||
        u16(bytes,26)!==16320 || u16(bytes,28)!==129 || bytes[30]!==1 ||
        (bytes[31]!==0 && bytes[31]!==3))
      throw new Error("Invalid FFT sampling metadata.");
    const sampleRateHz=50000000/period,binWidthHz=sampleRateHz/256;
    const fractionalScale=2**bytes[31];
    const bins=Array.from({length:129},(_,index)=>{
      const power=u32(bytes,32+4*index);
      if(power>33554432*fractionalScale*fractionalScale)throw new Error("FFT amplitude exceeds the ADC range.");
      const amplitudeVolts=Math.sqrt(power)/fractionalScale*(index===0||index===128?1:2)/gain*fullScaleMv/4096000;
      return {index,frequencyHz:index*binWidthHz,power,amplitudeVolts};
    });
    let peak=bins[1];
    for(const bin of bins.slice(2))if(bin.power>peak.power)peak=bin;
    peak=peak.power>16*fractionalScale*fractionalScale ? {...peak,binFrequencyHz:peak.frequencyHz} : null;
    // Estimate a tone between bins using the Hann main lobe in log magnitude.
    // This refines a peak readout; the graph retains the original FPGA bins.
    if(peak && peak.index>1 && peak.index<127) {
      const a=Math.log(Math.max(bins[peak.index-1].amplitudeVolts,1e-12));
      const b=Math.log(Math.max(peak.amplitudeVolts,1e-12));
      const c=Math.log(Math.max(bins[peak.index+1].amplitudeVolts,1e-12));
      const denominator=a-2*b+c;
      const offset=denominator<0 ? Math.max(-0.5,Math.min(0.5,0.5*(a-c)/denominator)) : 0;
      peak.frequencyHz=(peak.index+offset)*binWidthHz;
      peak.amplitudeVolts=Math.exp(b-0.25*(a-c)*offset);
    }
    return {id,focus:bytes[5],timebase:bytes[7],sampleRateHz,binWidthHz,
      nyquistHz:sampleRateHz/2,durationMs:elapsedTicks/50000,
      dcVolts:dcMean*fullScaleMv/4096000,bins,peak};
  }
  const FLAG_COMPLETE = 1;
  const FLAG_TRIGGERED = 2;
  const FLAG_GAP = 4;
  const FLAG_STOPPED = 8;

  function selectVgaTimebase(requestSeconds, samplePeriodCycles, plotSamples) {
    const requested = Number(requestSeconds);
    const cycles = Number(samplePeriodCycles);
    const samples = plotSamples === undefined ? 576 : Number(plotSamples);
    if (!Number.isFinite(requested) || requested <= 0) throw new RangeError("VGA window must be positive.");
    if (!Number.isFinite(cycles) || cycles <= 0) throw new RangeError("FPGA sample period is unavailable.");
    if (!Number.isFinite(samples) || samples <= 0) throw new RangeError("Plot width must be positive.");
    const baseWindowSeconds = cycles * samples / 50000000;
    const ideal = Math.log2(requested / baseWindowSeconds);
    const timebase = Math.max(0, Math.min(10, Math.round(ideal)));
    const actualWindowSeconds = baseWindowSeconds * (2 ** timebase);
    return {
      timebase,
      decimation: 2 ** timebase,
      actualWindowSeconds,
      minimumWindowSeconds: baseWindowSeconds,
      maximumWindowSeconds: baseWindowSeconds * 1024,
      limited: ideal < 0 ? "minimum" : ideal > 10 ? "maximum" : null
    };
  }

  function frequencyToHertz(value, unit) {
    const scales = {Hz: 1, kHz: 1000, MHz: 1000000};
    const numeric = Number(value), scale = scales[unit];
    if (!Number.isFinite(numeric) || numeric <= 0 || !scale) throw new RangeError("Generator frequency and unit are invalid.");
    return Math.max(1, Math.min(2000000, Math.round(numeric * scale)));
  }

  function bytesOf(input) {
    if (input instanceof Uint8Array) return input;
    if (input instanceof ArrayBuffer) return new Uint8Array(input);
    if (ArrayBuffer.isView(input)) return new Uint8Array(input.buffer, input.byteOffset, input.byteLength);
    if (Array.isArray(input)) return Uint8Array.from(input);
    throw new TypeError("Capture data must be an ArrayBuffer or byte array.");
  }

  function u16(bytes, offset) {
    return bytes[offset] | (bytes[offset + 1] << 8);
  }

  function u32(bytes, offset) {
    return (bytes[offset] |
      (bytes[offset + 1] << 8) |
      (bytes[offset + 2] << 16) |
      (bytes[offset + 3] << 24)) >>> 0;
  }

  function readAscii(bytes, offset, length) {
    let text = "";
    for (let i = 0; i < length; i++) text += String.fromCharCode(bytes[offset + i]);
    return text;
  }

  /*
   * Convert a sequence of uint32 hardware ticks to monotonic ticks. Unsigned
   * subtraction makes the normal 32-bit wrap unambiguous and keeps the raw
   * timestamp available for export and diagnostics.
   */
  function unwrapTicks(rawTicks) {
    const raw = Array.from(rawTicks, value => Number(value) >>> 0);
    const unwrapped = [];
    let total = 0;
    let previous = null;
    for (const tick of raw) {
      if (previous === null) {
        total = tick;
      } else {
        total += (tick - previous) >>> 0;
      }
      unwrapped.push(total);
      previous = tick;
    }
    return unwrapped;
  }

  function median(values) {
    const sorted = values.filter(Number.isFinite).slice().sort((a, b) => a - b);
    if (!sorted.length) return 0;
    const middle = Math.floor(sorted.length / 2);
    return sorted.length % 2 ? sorted[middle] : (sorted[middle - 1] + sorted[middle]) / 2;
  }

  function findGaps(samples, expectedTicks) {
    const deltas = [];
    for (let i = 1; i < samples.length; i++) {
      const delta = samples[i].ticks - samples[i - 1].ticks;
      if (delta > 0) deltas.push(delta);
    }
    const expected = Number(expectedTicks) > 0 ? Number(expectedTicks) : median(deltas);
    const gaps = [];
    if (!(expected > 0)) return { expectedTicks: 0, gaps };
    for (let i = 1; i < samples.length; i++) {
      const delta = samples[i].ticks - samples[i - 1].ticks;
      if (!(delta > expected * 1.5)) continue;
      gaps.push({
        before: i - 1,
        after: i,
        missing: Math.max(1, Math.round(delta / expected) - 1),
        fromTicks: samples[i - 1].ticks,
        toTicks: samples[i].ticks,
        deltaTicks: delta
      });
    }
    return { expectedTicks: expected, gaps };
  }

  function viewportForWindow(record, requestedSpanSec, pretriggerFraction) {
    const duration = Math.max(0, Number(record && record.durationSec) || 0);
    const requested = Math.max(0, Number(requestedSpanSec) || duration);
    const span = Math.min(duration, requested || duration);
    const fraction = Math.max(0, Math.min(1, Number(pretriggerFraction) || 0));
    const triggerSample = record && record.triggered && record.triggerMode !== 0 && Number.isInteger(record.triggerIndex)
      ? record.samples[record.triggerIndex] : null;
    const triggerSec = triggerSample && Number.isFinite(triggerSample.timeSec)
      ? triggerSample.timeSec : null;
    let startSec;
    if (triggerSec !== null) startSec = triggerSec - span * fraction;
    else startSec = duration - span;
    startSec = Math.max(0, Math.min(Math.max(0, duration - span), startSec));
    return {startSec, endSec: startSec + span, triggerSec};
  }

  function decodeCapture(input, options) {
    const bytes = bytesOf(input);
    const opts = options || {};
    if (bytes.length < HEADER_BYTES) throw new Error("Capture is shorter than its 64-byte header.");
    const magic = readAscii(bytes, 0, 4);
    if (magic !== "OCAP") throw new Error("Unsupported capture magic.");
    const version = bytes[4];
    if (version !== FORMAT_VERSION && version !== ENVELOPE_VERSION) throw new Error("Unsupported capture format version " + version + ".");
    const headerBytes = bytes[5];
    if (headerBytes < HEADER_BYTES || headerBytes > bytes.length) throw new Error("Invalid capture header length.");
    const flags = bytes[6];
    const focusChannel = bytes[7];
    const declaredRecords = u16(bytes, 8);
    const recordBytes = u16(bytes, 10) || RECORD_BYTES;
    const envelope = version === ENVELOPE_VERSION;
    if (recordBytes !== (envelope ? ENVELOPE_RECORD_BYTES : RECORD_BYTES)) throw new Error("Unsupported capture record size.");
    if (declaredRecords > MAX_RECORDS) throw new Error("Capture record count exceeds the supported maximum.");
    const samplePeriodTicks = u32(bytes, 12);
    const captureId = u32(bytes, 16);
    const triggerIndexRaw = u32(bytes, 20);
    const fullScaleMv = u16(bytes, 24);
    const configRevision = u16(bytes, 26);
    const firstTick = u32(bytes, 28);
    const configFingerprint = u32(bytes, 32);
    const averageMode = bytes[36];
    const triggerMode = bytes[37];
    const triggerLevel = u16(bytes, 38);
    const requestId = u32(bytes, 40);
    const artifactClockHz = u32(bytes, 44);
    const rawFlags = u32(bytes, 48);
    const availableRecords = Math.floor((bytes.length - headerBytes) / recordBytes);
    const recordCount = declaredRecords;
    const truncated = recordCount > availableRecords;
    if (truncated) throw new Error("Capture artifact is truncated: header declares " + declaredRecords + " records but only " + availableRecords + " are present.");
    const triggerIndexValid = triggerIndexRaw === 0xffffffff || triggerIndexRaw < declaredRecords;
    const focusChannelValid = focusChannel < 6;
    const fullScaleValid = fullScaleMv >= 1000 && fullScaleMv <= 9999;
    const metadataErrors = [];
    if (!focusChannelValid) metadataErrors.push("focus channel is out of range");
    if (!triggerIndexValid) metadataErrors.push("trigger index is out of range");
    if (!fullScaleValid) metadataErrors.push("full-scale calibration is out of range");
    const clockHz = Number(opts.clockHz || opts.sampleClockHz || artifactClockHz || 50000000);
    const rawTicks = [];
    const rawAdc = [];
    for (let i = 0; i < recordCount; i++) {
      const offset = headerBytes + i * recordBytes;
      rawTicks.push(u32(bytes, offset));
      rawAdc.push(u16(bytes, offset + 4));
    }
    if (rawTicks.length && rawTicks[0] !== firstTick) metadataErrors.push("first acquisition tick does not match the first record");
    const ticks = unwrapTicks(rawTicks);
    const firstUnwrapped = ticks.length ? ticks[0] : firstTick;
    const samples = rawAdc.map((adc, index) => {
      const offset = headerBytes + index * recordBytes;
      const low = envelope ? u16(bytes, offset + 6) : adc;
      const high = envelope ? u16(bytes, offset + 8) : adc;
      return {
        index,
        tick: rawTicks[index],
        ticks: ticks[index] - firstUnwrapped,
        timeSec: (ticks[index] - firstUnwrapped) / clockHz,
        timeMs: (ticks[index] - firstUnwrapped) * 1000 / clockHz,
        adc,
        low,
        high,
        valid: adc <= ADC_MAX && low <= adc && high >= adc && high <= ADC_MAX
      };
    });
    const gapInfo = findGaps(samples, samplePeriodTicks);
    const gaps = gapInfo.gaps;
    const hasGap = (flags & FLAG_GAP) !== 0 || gaps.length > 0;
    const validSamples = samples.filter(sample => sample.valid);
    const durationSec = samples.length > 1 ? samples[samples.length - 1].timeSec : 0;
    const measuredPeriodTicks = gapInfo.expectedTicks;
    const sampleRateHz = measuredPeriodTicks > 0 ? clockHz / measuredPeriodTicks : 0;
    return {
      format: "OCAP",
      version,
      envelope,
      headerBytes,
      recordBytes,
      bytes: bytes.length,
      flags,
      complete: (flags & FLAG_COMPLETE) !== 0 && !truncated,
      triggered: (flags & FLAG_TRIGGERED) !== 0,
      stopped: (flags & FLAG_STOPPED) !== 0,
      hasGap,
      truncated,
      focusChannel,
      metadataValid: metadataErrors.length === 0,
      metadataErrors,
      declaredRecords,
      recordCount,
      validCount: validSamples.length,
      samplePeriodTicks,
      sampleRateHz,
      clockHz,
      captureId,
      triggerIndex: triggerIndexRaw === 0xffffffff ? null : triggerIndexRaw,
      fullScaleMv: fullScaleValid ? fullScaleMv : Number(opts.fullScaleMv || 5000),
      configRevision,
      configFingerprint,
      averageMode,
      averaging: averageMode,
      triggerMode,
      triggerLevel,
      requestId,
      rawFlags,
      firstTick,
      durationSec,
      samples,
      validSamples,
      gaps,
      expectedTicks: gapInfo.expectedTicks
    };
  }

  function valueToVolts(adc, fullScaleMv) {
    return Number(adc) * Number(fullScaleMv || 5000) / 4096000;
  }

  function measureRecord(record, range) {
    const start = range && Number.isFinite(range.startSec) ? range.startSec : -Infinity;
    const end = range && Number.isFinite(range.endSec) ? range.endSec : Infinity;
    const selected = record.samples.filter(sample =>
      sample.valid && sample.timeSec >= start && sample.timeSec <= end);
    const artifactValid = record.metadataValid !== false && record.complete !== false &&
      record.validCount === record.recordCount;
    const result = {
      valid: selected.length > 0 && artifactValid,
      count: selected.length,
      min: null,
      max: null,
      peakToPeak: null,
      average: null,
      rms: null,
      frequencyHz: null,
      periodSec: null,
      dutyPercent: null,
      reason: "",
      hasGap: record.gaps.some(gap => {
        const t = record.samples[gap.after] && record.samples[gap.after].timeSec;
        return t >= start && t <= end;
      })
    };
    if (!selected.length) {
      result.reason = "No valid ADC samples in the selected window.";
      return result;
    }
    const values = selected.map(sample => sample.adc);
    result.min = Math.min(...selected.map(sample => sample.low));
    result.max = Math.max(...selected.map(sample => sample.high));
    result.peakToPeak = result.max - result.min;
    result.average = values.reduce((sum, value) => sum + value, 0) / values.length;
    result.rms = Math.sqrt(values.reduce((sum, value) => sum + value * value, 0) / values.length);
    if (!artifactValid) {
      result.reason = (record.metadataErrors && record.metadataErrors.length)
        ? "Invalid capture metadata: " + record.metadataErrors.join(", ") + "."
        : "Capture is incomplete or contains invalid ADC values; measurements are suppressed.";
      result.valid = false;
      return result;
    }
    if (selected.length < 8) {
      result.reason = "At least eight valid samples are required for timing measurements.";
      result.valid = true;
      return result;
    }
    if (result.hasGap) {
      result.reason = "Timestamp gap detected; timing measurements are suppressed.";
      result.valid = true;
      return result;
    }
    if (result.peakToPeak < Math.max(12, ADC_MAX * 0.005)) {
      result.reason = "Signal amplitude is too small for a reliable frequency estimate.";
      return result;
    }
    const midpoint = (result.min + result.max) / 2;
    const hysteresis = Math.max(2, (result.max - result.min) * 0.10);
    const lowThreshold = midpoint - hysteresis;
    const highThreshold = midpoint + hysteresis;
    const crossings = [];
    let armed = false;
    for (let i = 1; i < selected.length; i++) {
      if (selected[i].adc <= lowThreshold) armed = true;
      if (armed && selected[i].adc >= highThreshold) {
        crossings.push(selected[i].timeSec);
        armed = false;
      }
    }
    if (crossings.length < 2) {
      result.reason = "Record is too short for a reliable frequency estimate.";
      return result;
    }
    const periods = [];
    for (let i = 1; i < crossings.length; i++) {
      const period = crossings[i] - crossings[i - 1];
      if (period > 0) periods.push(period);
    }
    if (!periods.length) {
      result.reason = "Timestamp spacing is insufficient for a frequency estimate.";
      return result;
    }
    const period = median(periods);
    const stable = periods.filter(value => value >= period * 0.65 && value <= period * 1.35);
    const sampleIntervals = [];
    for (let i = 1; i < selected.length; i++) {
      const interval = selected[i].timeSec - selected[i - 1].timeSec;
      if (interval > 0) sampleIntervals.push(interval);
    }
    const sampleInterval = median(sampleIntervals);
    if (stable.length < 2 || !(sampleInterval > 0) || period / sampleInterval < 8 ||
        selected[selected.length - 1].timeSec - selected[0].timeSec < period * 1.5) {
      result.reason = "Record is too short for a reliable frequency estimate.";
      result.valid = true;
      return result;
    }
    result.periodSec = stable.reduce((sum, value) => sum + value, 0) / stable.length;
    result.frequencyHz = 1 / result.periodSec;
    const firstCycle = crossings[0], lastCycle = crossings[crossings.length - 1];
    let highDuration = 0, totalDuration = 0;
    for (let i = 1; i < selected.length; i++) {
      const left = selected[i - 1], right = selected[i];
      const segmentStart = Math.max(firstCycle, left.timeSec);
      const segmentEnd = Math.min(lastCycle, right.timeSec);
      if (segmentEnd <= segmentStart) continue;
      const duration = segmentEnd - segmentStart;
      totalDuration += duration;
      if (left.adc >= midpoint) highDuration += duration;
    }
    result.dutyPercent = totalDuration > 0 ? 100 * highDuration / totalDuration : null;
    return result;
  }

  function csvForCapture(record, range) {
    const measurement = measureRecord(record, range);
    const lines = [
      "# FPGA Oscilloscope capture",
      "# format=" + record.format + " version=" + record.version,
      "# capture_id=" + record.captureId,
      "# focus_channel=" + record.focusChannel,
      "# records=" + record.recordCount + " valid=" + record.validCount,
      "# sample_rate_hz=" + (record.sampleRateHz || 0),
      "# clock_hz=" + record.clockHz,
      "# full_scale_mv=" + record.fullScaleMv,
      "# trigger_mode=" + (record.triggerMode || "unknown"),
      "# trigger_level=" + (record.triggerLevel === undefined ? "unknown" : record.triggerLevel),
      "# averaging=" + (record.averaging === undefined ? "unknown" : record.averaging),
      "# config_fingerprint=" + (record.configFingerprint || "unknown"),
      "# triggered=" + record.triggered,
      "# complete=" + record.complete,
      "# gaps=" + record.gaps.length,
      "# measurement_valid=" + measurement.valid,
      "time_ms,channel,tick,adc,volts,valid,low,high"
    ];
    for (const sample of record.samples) {
      lines.push([
        sample.timeMs.toFixed(6),
        record.focusChannel,
        sample.tick >>> 0,
        sample.adc,
        valueToVolts(sample.adc, record.fullScaleMv).toFixed(6),
        sample.valid ? "1" : "0",
        sample.low,
        sample.high
      ].join(","));
    }
    return lines.join("\n") + "\n";
  }

  return {
    HEADER_BYTES,
    RECORD_BYTES,
    MAX_RECORDS,
    FORMAT_VERSION,
    ENVELOPE_VERSION,
    ENVELOPE_RECORD_BYTES,
    VGA_PLOT_SAMPLES,
    vgaTimeOptions,
    decodeLiveFrame,
    decodeRawBatch,
    decodeFftFrame,
    FLAG_COMPLETE,
    FLAG_TRIGGERED,
    FLAG_GAP,
    FLAG_STOPPED,
    selectVgaTimebase,
    frequencyToHertz,
    unwrapTicks,
    findGaps,
    viewportForWindow,
    decodeCapture,
    measureRecord,
    valueToVolts,
    csvForCapture
  };
});
</script>
  <script>
(() => {
  "use strict";
  const CaptureProtocol = globalThis.FpgaOscilloscopeProtocol;
  if (!CaptureProtocol) throw new Error("Capture protocol helper is unavailable.");
  // The live view uses FPGA columns with one shared axis for all channels.
  const ADC_MAX = 4095, ADC_COUNTS = 4096, CAPACITY = 512;
  const TRACE_COLORS = ["#53efff","#ffd166","#70e000","#ff70a6","#9b8cff","#ff8c42"];
  let fullScaleMv = 5000, measuredSampleCycles = 0, labeledSampleCycles = 0;
  const traces = Array.from({length:6},()=>({values:new Uint16Array(CAPACITY),lows:new Uint16Array(CAPACITY),highs:new Uint16Array(CAPACITY),times:new Float64Array(CAPACITY),head:0,count:0,latest:0}));
  let paused = false, drawNeeded = true;
  let lastEventAt = 0, connected = false;
  let lastNetworkAt = 0, lastFetchedFrameId = null;
  let viewMode = "live", captureRecord = null, captureStatusTimer = 0;
  let liveFrame = null, lastLiveFrameAt = 0;
  let captureViewport = {startSec: 0, endSec: 1};
  let captureCursorA = null, captureCursorB = null;
  let pointerState = null;
  let autoSnapshotTimer = 0, autoSnapshotRunning = false, autoSnapshotGeneration = 0;
  let manualMode = false, boardFrameKnown = false;
  let timeOptionsPeriod = 0, timeOptionsKnown = false;
  let fftSnapshot=null, fftBusy=false, fftCancelRequested=false;
  let phoneSource="snapshot", rawClock=null, rawTimeMs=0, rawViewTimeMs=0, rawWindowMs=0;
  const rawBuckets=Array.from({length:6},()=>({id:null,sum:0,count:0}));

  const $ = id => document.getElementById(id);
  const canvas = $("scope"), ctx = canvas.getContext("2d", {alpha:false});
  // Match the original FPGA design: 4096 ADC codes span calibrated full scale.

  const volts = raw => raw * fullScaleMv / (ADC_COUNTS * 1000);
  const formatVolts = raw => volts(raw).toFixed(3) + " V";
  const pad4 = value => String(value).padStart(4, "0");

  function formatAxisTime(seconds, precision) {
    const absolute = Math.abs(seconds);
    if (precision && absolute > 0) {
      const scale = absolute < 0.001 ? 1000000 : absolute < 1 ? 1000 : 1;
      const unit = scale === 1000000 ? " us" : scale === 1000 ? " ms" : " s";
      return Number((seconds * scale).toPrecision(precision)) + unit;
    }
    if (absolute < 0.0000005) return "0";
    if (absolute < 0.001) return (seconds * 1000000).toFixed(absolute < 0.00001 ? 1 : 0) + " us";
    if (absolute < 1) return (seconds * 1000).toFixed(absolute < 0.01 ? 1 : 0) + " ms";
    return seconds.toFixed(absolute < 10 ? 2 : 1) + " s";
  }

  function selectedPhoneWindowMs() {
    return vgaWindowForTimebase(Number($("timebase").value)) * 1000;
  }

  function updateXAxisReadout(windowSeconds) {
    $("xAxisReadout").textContent = formatAxisTime(windowSeconds, 4) + " window · " + formatAxisTime(windowSeconds / 10, 4) + "/div";
  }

  function vgaWindowForTimebase(timebase){
    if(measuredSampleCycles<=0)return 0;
    return measuredSampleCycles*(2**timebase)*576/50000000;
  }

  function setVgaTimebaseForWindow(seconds){
    if(measuredSampleCycles<=0)return;
    $("timebase").value=String(CaptureProtocol.selectVgaTimebase(seconds,measuredSampleCycles).timebase);
    updateVgaTimeControl(false);
  }

  function updateVgaTimeControl(sendToFpga=false){
    const timebase=Math.max(0,Math.min(10,Math.round(Number($("timebase").value)||0)));
    $("timebase").value=String(timebase);
    $("vgaTimebaseValue").textContent=`X${2**timebase}`;
    const options = CaptureProtocol.vgaTimeOptions(measuredSampleCycles || 800);
    const select = $("totalTime");
    select.disabled = manualMode;
    if (select.children.length !== 11) {
      select.replaceChildren(...options.map(option => {
        const element = document.createElement("option");
        element.value = String(option.timebase);
        return element;
      }));
    }
    const period = measuredSampleCycles || 800, known = measuredSampleCycles > 0;
    // Keep native menus intact while open and avoid relabeling ADC jitter.
    if (document.activeElement !== select && (!timeOptionsPeriod || known !== timeOptionsKnown ||
        Math.abs(period-timeOptionsPeriod) > Math.max(2,timeOptionsPeriod*0.005))) {
      options.forEach((option,index)=>{
        select.children[index].textContent = known
          ? `${formatAxisTime(option.seconds,4)} (${formatAxisTime(option.seconds/10,4)}/div)`
          : `X${option.decimation} — labels update on connection`;
      });
      timeOptionsPeriod=period;timeOptionsKnown=known;
    }
    if(select.value!==String(timebase))select.value=String(timebase);
    const windowSeconds=vgaWindowForTimebase(timebase),actual=$("vgaWindowActual");
    if (!captureRecord) captureViewport = {startSec: 0, endSec: windowSeconds || 1};
    actual.textContent=windowSeconds>0
      ? `${formatAxisTime(windowSeconds, 4)} total · ${formatAxisTime(windowSeconds/10, 4)}/div`
      : "Shared by VGA and phone";
    drawNeeded = true;
    if(sendToFpga)applyDisplaySettings();
  }

  function setPill(element, state, text) {
    element.classList.remove("ok", "bad");
    if (state) element.classList.add(state);
    element.querySelector("span").textContent = text;
  }

  function pushSample(channel,value,low=value,high=value,timestamp=performance.now()) {
    const trace=traces[channel];
    trace.values[trace.head]=value;trace.lows[trace.head]=low;trace.highs[trace.head]=high;
    trace.times[trace.head]=timestamp;trace.latest=value;
    trace.head=(trace.head+1)%CAPACITY;if(trace.count<CAPACITY)trace.count++;
  }

  function indexAt(trace,logicalIndex) {
    return (trace.head-trace.count+logicalIndex+CAPACITY)%CAPACITY;
  }

  function enabledChannels(){return [...document.querySelectorAll(".channel-check:checked")].map(input=>Number(input.value));}
  function channelMask(){return enabledChannels().reduce((mask,ch)=>mask|(1<<ch),0);}
  function updateChannelButtons(){
    drawNeeded=true;
  }
  function clearSamples() {
    for(const trace of traces){trace.head=0;trace.count=0;}
    for(const bucket of rawBuckets){bucket.id=null;bucket.sum=0;bucket.count=0;}
    drawNeeded=true;
  }
  function appendRawBatch(data) {
    const batch=CaptureProtocol.decodeRawBatch(data,rawClock,rawTimeMs);
    if(batch.reset)clearSamples();
    rawClock=batch.clockUs;rawTimeMs=batch.timeMs;
    const windowMs=selectedPhoneWindowMs();
    if(!paused&&Math.abs(windowMs-rawWindowMs)>Math.max(.01,rawWindowMs*.005)) {
      clearSamples();rawWindowMs=windowMs;
    }
    const bucketMs=Math.max(0.001,windowMs/(CAPACITY-1));
    if(!paused)for(const sample of batch.samples) {
      if(!(channelMask()&(1<<sample.channel)))continue;
      const trace=traces[sample.channel],bucket=rawBuckets[sample.channel];
      const id=Math.floor(sample.timeMs/bucketMs);
      if(bucket.id!==id) {
        bucket.id=id;bucket.sum=sample.adc;bucket.count=1;
        pushSample(sample.channel,sample.adc,sample.adc,sample.adc,sample.timeMs);
      } else {
        bucket.sum+=sample.adc;bucket.count++;
        const index=(trace.head-1+CAPACITY)%CAPACITY;
        trace.values[index]=Math.round(bucket.sum/bucket.count);
        trace.lows[index]=Math.min(trace.lows[index],sample.adc);
        trace.highs[index]=Math.max(trace.highs[index],sample.adc);
        trace.times[index]=sample.timeMs;trace.latest=sample.adc;
      }
    }
    if(!paused){rawViewTimeMs=rawTimeMs;drawNeeded=true;}
    $("measurementSource").textContent="UART live · undersampled ADC readings · "+(batch.drops?`${batch.drops} readings skipped by Wi-Fi`:"time uses Pico receipt timestamps");
  }
  function setPhoneSource(next) {
    phoneSource=next==="raw"?"raw":"snapshot";
    lastFetchedFrameId=null;rawClock=null;rawTimeMs=0;rawViewTimeMs=0;rawWindowMs=0;clearSamples();
    for(const [id,mode] of [["snapshotSourceButton","snapshot"],["rawSourceButton","raw"]]) {
      const selected=phoneSource===mode;
      $(id).classList.toggle("active",selected);$(id).setAttribute("aria-pressed",String(selected));
    }
    $("phoneSourceHint").textContent=phoneSource==="raw"?"Undersampled · fast updates":"Same window as the VGA display";
    if(phoneSource==="snapshot"&&liveFrame)for(let ch=0;ch<6;ch++)for(const point of liveFrame.traces[ch])
      pushSample(ch,point.adc,point.low,point.high,point.timeMs);
    drawNeeded=true;
  }

  function resizeCanvas() {
    const rect = canvas.getBoundingClientRect();
    const ratio = Math.min(window.devicePixelRatio || 1, 2);
    const width = Math.max(320, Math.round(rect.width * ratio));
    const height = Math.max(240, Math.round(rect.height * ratio));
    if (canvas.width !== width || canvas.height !== height) {
      canvas.width = width; canvas.height = height; drawNeeded = true;
    }
  }

  function analyzeLiveTrace(trace, range) {
    let count=0,min=ADC_MAX,max=0,sum=0,sumSquares=0;
    const samples=[];
    for(let i=0;i<trace.count;i++){
      const j=indexAt(trace,i),time=trace.times[j];
      if(time<range.start||time>range.end)continue;
      const value=trace.values[j];
      min=Math.min(min,trace.lows[j]);max=Math.max(max,trace.highs[j]);
      sum+=value;sumSquares+=value*value;count++;samples.push({time,value});
    }
    if(!count)return {count:0,min:null,max:null,peakToPeak:null,average:null,rms:null,frequencyHz:null,periodMs:null,dutyPercent:null};
    const peakToPeak=max-min;
    if(samples.length<3||peakToPeak<Math.max(12,ADC_MAX*0.005))return {count,min,max,peakToPeak,average:sum/count,rms:Math.sqrt(sumSquares/count),frequencyHz:null,periodMs:null,dutyPercent:null};
    const midpoint=(min+max)/2,hysteresis=Math.max(2,peakToPeak*0.1);
    const low=midpoint-hysteresis,high=midpoint+hysteresis,crossings=[];
    let highState=samples[0].value>=midpoint,highDuration=0,totalDuration=0;
    for(let i=1;i<samples.length;i++){
      const elapsed=samples[i].time-samples[i-1].time;
      if(elapsed>0){totalDuration+=elapsed;if(highState)highDuration+=elapsed;}
      if(highState&&samples[i].value<=low)highState=false;
      else if(!highState&&samples[i].value>=high){highState=true;crossings.push(samples[i].time);}
    }
    const periods=[];
    for(let i=1;i<crossings.length;i++)if(crossings[i]>crossings[i-1])periods.push(crossings[i]-crossings[i-1]);
    periods.sort((a,b)=>a-b);
    const periodMs=periods.length>=2?periods[Math.floor(periods.length/2)]:null;
    return {count,min,max,peakToPeak,average:sum/count,rms:Math.sqrt(sumSquares/count),frequencyHz:periodMs?1000/periodMs:null,periodMs,dutyPercent:totalDuration>0?100*highDuration/totalDuration:null};
  }

  function analysisVoltage(value) { return value===null?"--":volts(value).toFixed(3)+" V"; }

  function renderLiveChannelAnalysis(range) {
    const focus=Number($("channel").value);
    $("channelAnalysisBody").innerHTML=enabledChannels().map(ch=>{
      const trace=traces[ch],measurement=analyzeLiveTrace(trace,range),focusLabel=ch===focus?'<span class="focus-tag">FOCUS</span>':'';
      return `<tr class="${ch===focus?"focus":""}"><td><span class="channel-key" style="--channel:${TRACE_COLORS[ch]}">CH${ch}</span>${focusLabel}</td>`+
        `<td>${trace.count?analysisVoltage(trace.latest):"--"}</td><td>${analysisVoltage(measurement.min)}</td><td>${analysisVoltage(measurement.max)}</td>`+
        `<td>${analysisVoltage(measurement.peakToPeak)}</td><td>${analysisVoltage(measurement.average)}</td><td>${analysisVoltage(measurement.rms)}</td>`+
        `<td>${formatFrequencyHz(measurement.frequencyHz)}</td></tr>`;
    }).join("")||'<tr><td colspan="8">No channels enabled.</td></tr>';
  }

  function drawScope() {
    if (viewMode === "capture") {
      drawCaptureScope();
      return;
    }
    resizeCanvas();
    const w = canvas.width, h = canvas.height, dpr = Math.min(window.devicePixelRatio || 1, 2);
    const left = 66*dpr, right = 18*dpr, top = 56*dpr, bottom = 38*dpr;
    const plotW = w-left-right, plotH = h-top-bottom;
    ctx.fillStyle = "#03070b"; ctx.fillRect(0,0,w,h);

    ctx.lineWidth = 1; ctx.strokeStyle = "#172738"; ctx.beginPath();
    for (let x=0; x<=10; x++) { const px=left+plotW*x/10; ctx.moveTo(px,top); ctx.lineTo(px,top+plotH); }
    for (let y=0; y<=8; y++) { const py=top+plotH*y/8; ctx.moveTo(left,py); ctx.lineTo(left+plotW,py); }
    if ($("gridEnable").checked) ctx.stroke();
    ctx.strokeStyle="#2b455d"; ctx.beginPath();
    ctx.moveTo(left,top+plotH/2); ctx.lineTo(left+plotW,top+plotH/2);
    ctx.moveTo(left+plotW/2,top); ctx.lineTo(left+plotW/2,top+plotH); ctx.stroke();

    const raw=phoneSource==="raw";
    const windowMs = !raw&&liveFrame ? liveFrame.windowMs : selectedPhoneWindowMs();
    if (!(windowMs > 0)) return;
    const triggerMode = $("triggerMode").value;
    const triggerRaw = Number($("triggerLevel").value);
    const pretrigger=[0.10,0.25,0.50,0.75][Number($("triggerPosition").value)];
    const focus=Number($("channel").value),focusTrace=traces[focus];
    const enabled=enabledChannels();

    const range=raw?{start:rawViewTimeMs-windowMs,end:rawViewTimeMs}:{start:0,end:windowMs};
    let min=ADC_MAX, max=0, visible=0;
    for(let i=0;i<focusTrace.count;i++){const j=indexAt(focusTrace,i),t=focusTrace.times[j];if(t>=range.start&&t<=range.end){if(focusTrace.lows[j]<min)min=focusTrace.lows[j];if(focusTrace.highs[j]>max)max=focusTrace.highs[j];visible++;}}
    if (!visible) { min=0; max=ADC_MAX; }
    const scale=1<<Number($("vertical").value);
    const center=2048+(Number($("verticalPosition").value)-50)*32;
    let yMin=center-2048/scale,yMax=center+2048/scale;

    const yOf = v => top + Math.max(0,Math.min(plotH,plotH-(v-yMin)*plotH/(yMax-yMin)));
    if(!raw&&triggerMode!=="free" && triggerRaw>=yMin && triggerRaw<=yMax){ const ty=yOf(triggerRaw); ctx.setLineDash([6*dpr,5*dpr]);ctx.strokeStyle="#ffc85799";ctx.beginPath();ctx.moveTo(left,ty);ctx.lineTo(left+plotW,ty);ctx.stroke();ctx.setLineDash([]); }
    if(!raw&&triggerMode!=="free"){const tx=left+plotW*pretrigger;ctx.setLineDash([4*dpr,5*dpr]);ctx.strokeStyle="#ffc85766";ctx.beginPath();ctx.moveTo(tx,top);ctx.lineTo(tx,top+plotH);ctx.stroke();ctx.setLineDash([]);}

    ctx.font=`500 ${12*dpr}px ui-monospace,monospace`;ctx.fillStyle="#c4d4e5";ctx.textAlign="right";
    for(let y=0;y<=4;y++){const raw=yMax-(yMax-yMin)*y/4;ctx.fillText(volts(raw).toFixed(2)+"V",left-6*dpr,top+plotH*y/4+3*dpr);}
    const timeTicks=plotW/dpr<500?4:8;
    for(let x=0;x<=timeTicks;x++){ctx.textAlign=x===0?"left":x===timeTicks?"right":"center";const relative=raw||triggerMode==="free"?(x/timeTicks-1):(x/timeTicks-pretrigger);const seconds=windowMs*relative/1000;ctx.fillText(formatAxisTime(seconds),left+plotW*x/timeTicks,h-12*dpr);}
    updateXAxisReadout(windowMs / 1000);

    $("traceLegend").innerHTML=enabled.map(ch=>`<span class="trace-chip" style="color:${TRACE_COLORS[ch]}">CH${ch} ${traces[ch].count?volts(traces[ch].latest).toFixed(2)+"V":"--"}${ch===focus?" · FOCUS":""}</span>`).join("");
    for(const ch of enabled){
      const trace=traces[ch];if(trace.count<2)continue;
      const pixelColumns=Math.max(1,Math.floor(plotW/dpr));
      const bucketMin=new Float32Array(pixelColumns),bucketMax=new Float32Array(pixelColumns);
      bucketMin.fill(Infinity);bucketMax.fill(-Infinity);let pointCount=0;
      for(let i=0;i<trace.count;i++){
        const j=indexAt(trace,i),t=trace.times[j];if(t<range.start||t>range.end)continue;
        const column=Math.max(0,Math.min(pixelColumns-1,Math.floor((t-range.start)*pixelColumns/windowMs)));
        bucketMin[column]=Math.min(bucketMin[column],trace.lows[j]);bucketMax[column]=Math.max(bucketMax[column],trace.highs[j]);pointCount++;
      }
      ctx.lineJoin="round";ctx.lineCap="round";
      if (liveFrame||raw) {
        ctx.beginPath();
        for(let i=0;i<trace.count;i++){
          const j=indexAt(trace,i),t=trace.times[j];if(t<range.start||t>range.end)continue;
          const x=left+(t-range.start)*plotW/windowMs;
          ctx.moveTo(x,yOf(trace.lows[j]));ctx.lineTo(x,yOf(trace.highs[j]));
        }
        ctx.strokeStyle=TRACE_COLORS[ch]+"44";ctx.lineWidth=1*dpr;ctx.stroke();
      }
      if(pointCount<=pixelColumns*1.5){
        ctx.beginPath();let started=false;
        for(let i=0;i<trace.count;i++){const j=indexAt(trace,i),t=trace.times[j];if(t<range.start||t>range.end)continue;const x=left+(t-range.start)*plotW/windowMs,y=yOf(trace.values[j]);if(!started){ctx.moveTo(x,y);started=true;}else ctx.lineTo(x,y);}
        ctx.strokeStyle=TRACE_COLORS[ch];ctx.lineWidth=(ch===focus?1.6:1.15)*dpr;ctx.stroke();
      }else{
        // At dense time ranges, one min/max envelope per physical pixel
        // prevents aliased scribbles while retaining narrow edges and peaks.
        ctx.beginPath();for(let x=0;x<pixelColumns;x++)if(bucketMin[x]!==Infinity){const px=left+(x+0.5)*dpr;ctx.moveTo(px,yOf(bucketMax[x]));ctx.lineTo(px,yOf(bucketMin[x]));}
        ctx.strokeStyle=TRACE_COLORS[ch];ctx.lineWidth=(ch===focus?1.6:1.1)*dpr;ctx.stroke();
      }
    }

    const measurement=analyzeLiveTrace(focusTrace,range);
    $("voltageText").textContent=focusTrace.count?`CH${focus}  ${formatVolts(focusTrace.latest)}`:"Waiting for signal";
    $("rawText").textContent=focusTrace.count?"ADC "+pad4(focusTrace.latest):"";
    $("minText").textContent=measurement.count?formatVolts(measurement.min):"--";$("maxText").textContent=measurement.count?formatVolts(measurement.max):"--";
    $("ppText").textContent=measurement.count?volts(measurement.peakToPeak).toFixed(3)+" V":"--";$("avgText").textContent=measurement.count?formatVolts(measurement.average):"--";
    $("rmsText").textContent=measurement.count?formatVolts(measurement.rms):"--";
    $("frequencyText").textContent=formatFrequencyHz(measurement.frequencyHz);
    $("periodText").textContent=measurement.periodMs?formatPeriodSeconds(measurement.periodMs/1000):"--";
    $("dutyText").textContent=measurement.dutyPercent===null?"-- %":measurement.dutyPercent.toFixed(1)+" %";
    $("samplesText").textContent=String(traces.reduce((total,trace)=>total+trace.count,0));
    $("triggerText").textContent=raw?(paused?"UART · HOLD":"UART · LIVE"):(paused?"HOLD · ":"LIVE · ")+triggerMode.toUpperCase();
    renderLiveChannelAnalysis(range);
  }

  function formatCaptureRate(hz) {
    if (!(hz > 0)) return "--";
    if (hz >= 1000000) return (hz / 1000000).toFixed(3) + " MS/s";
    if (hz >= 1000) return (hz / 1000).toFixed(3) + " kS/s";
    return hz.toFixed(2) + " S/s";
  }

  function formatFrequencyHz(hz) {
    if (!(hz > 0)) return "-- Hz";
    if (hz >= 1000000) return (hz / 1000000).toFixed(3) + " MHz";
    if (hz >= 1000) return (hz / 1000).toFixed(3) + " kHz";
    return hz.toFixed(hz < 10 ? 3 : 2) + " Hz";
  }

  function formatPeriodSeconds(seconds) {
    if (!(seconds > 0)) return "--";
    return formatAxisTime(seconds);
  }

  function formatCaptureDuration(seconds) {
    if (!(seconds >= 0)) return "--";
    if (seconds < 1) return (seconds * 1000).toFixed(3) + " ms";
    return seconds.toFixed(seconds < 10 ? 3 : 2) + " s";
  }

  function formatCaptureVolts(raw) {
    return CaptureProtocol.valueToVolts(raw, captureRecord ? captureRecord.fullScaleMv : fullScaleMv).toFixed(3) + " V";
  }

  function setCapturePanelState(state, message) {
    const panel = document.querySelector(".capture-panel");
    if (panel) panel.dataset.state = state;
    if (message !== undefined) $("captureStatus").textContent = message;
    $("captureStateText").textContent = state;
  }

  function renderCaptureMeta(status) {
    const source = status || {};
    const record = captureRecord;
    const count = record ? record.recordCount : Number(source.recordCount || source.records || source.received || 0);
    const periodTicks = Number(source.samplePeriodTicks || source.period || 0);
    const rate = record ? record.sampleRateHz : Number(source.sampleRateHz || source.sampleRate || (periodTicks > 0 ? 50000000 / periodTicks : 0));
    const duration = record ? record.durationSec : Number(source.durationSec || source.duration || (count > 1 && periodTicks > 0 ? (count - 1) * periodTicks / 50000000 : 0));
    const trigger = record && record.triggerIndex !== null
      ? String(record.triggerIndex) + " / " + record.focusChannel
      : source.triggerIndex !== undefined ? String(source.triggerIndex) : source.trigger !== undefined ? String(source.trigger) : "--";
    const triggerMode = record ? record.triggerMode : source.triggerMode;
    const triggerLevel = record ? record.triggerLevel : source.triggerLevel;
    const modeNames = ["free", "rising", "falling", "auto"];
    const triggerSetup = triggerMode === null || triggerMode === undefined ? "--" :
      (modeNames[Number(triggerMode)] || String(triggerMode)) +
      (triggerLevel !== null && triggerLevel !== undefined && Number.isFinite(Number(triggerLevel)) ? " @ " + CaptureProtocol.valueToVolts(triggerLevel, record ? record.fullScaleMv : fullScaleMv).toFixed(3) + " V" : "");
    const averaging = record ? (record.averaging === null ? null : record.averaging) : source.averaging;
    const averageNames = ["none", "4x", "16x", "64x"];
    const fingerprint = record && record.configFingerprint !== null ? record.configFingerprint : source.configFingerprint;
    $("captureRecordText").textContent = count > 0 ? count.toLocaleString() + (record && record.truncated ? " (truncated)" : "") : "--";
    $("captureRateText").textContent = formatCaptureRate(rate);
    $("captureDurationText").textContent = duration > 0 ? formatCaptureDuration(duration) : "--";
    $("captureTriggerText").textContent = trigger;
    $("captureTriggerSetupText").textContent = triggerSetup;
    $("captureAverageText").textContent = averaging === null || averaging === undefined ? "--" : (averageNames[Number(averaging)] || String(averaging));
    $("captureConfigText").textContent = fingerprint === null || fingerprint === undefined ? "--" : "0x" + Number(fingerprint).toString(16).padStart(8, "0");
    $("captureQualityText").textContent = record
      ? (record.complete ? (record.hasGap ? "complete, timestamp gap" : "complete") : "incomplete")
      : (source.error || source.valid === false ? "error" : source.complete ? "complete" : "--");
  }

  function updateCaptureCursorReadout(measurement) {
    const element = $("captureCursorReadout");
    if (!captureRecord || viewMode !== "capture") {
      element.hidden = true;
      return;
    }
    element.hidden = false;
    const sampleA = captureCursorA === null ? null : nearestCaptureSample(captureRecord, captureCursorA);
    const sampleB = captureCursorB === null ? null : nearestCaptureSample(captureRecord, captureCursorB);
    const a = sampleA ? formatCaptureDuration(sampleA.timeSec) + " / " + formatCaptureVolts(sampleA.adc) : "--";
    const b = sampleB ? formatCaptureDuration(sampleB.timeSec) + " / " + formatCaptureVolts(sampleB.adc) : "--";
    const delta = captureCursorA !== null && captureCursorB !== null
      ? Math.abs(captureCursorB - captureCursorA) : null;
    const voltsDelta = measurement && measurement.valid && sampleA && sampleB
      ? CaptureProtocol.valueToVolts(sampleB.adc-sampleA.adc,captureRecord.fullScaleMv) : null;
    element.textContent = delta === null
      ? "Cursor A " + a + " | Cursor B --"
      : "A " + a + " | B " + b + " | dt " + formatCaptureDuration(delta) + " | 1/dt " + formatFrequencyHz(delta>0?1/delta:null) + " | dV " + (voltsDelta === null ? "--" : voltsDelta.toFixed(4) + " V");
  }

  function nearestCaptureSample(record, time) {
    let best = null, distance = Infinity;
    for (const sample of record.validSamples) {
      const nextDistance = Math.abs(sample.timeSec-time);
      if(nextDistance<distance){distance=nextDistance;best=sample;}
    }
    return best;
  }

  function resetCaptureViewport() {
    if (captureRecord) { fitCaptureToVgaWindow(); return; }
    const end = captureRecord && captureRecord.durationSec > 0 ? captureRecord.durationSec : 1;
    captureViewport = {startSec: 0, endSec: end};
    captureCursorA = null;
    captureCursorB = null;
    drawNeeded = true;
  }

  function fitCaptureToVgaWindow() {
    if (!captureRecord) return;
    const pretrigger = [0.10,0.25,0.50,0.75][Number($("triggerPosition").value)];
    const vgaSpanSeconds = vgaWindowForTimebase(Number($("timebase").value)) || captureRecord.durationSec;
    const viewport = CaptureProtocol.viewportForWindow(
      captureRecord, vgaSpanSeconds, pretrigger);
    captureViewport = {startSec: viewport.startSec, endSec: viewport.endSec};
    captureCursorA = null;
    captureCursorB = null;
    drawNeeded = true;
  }

  function setViewMode(mode) {
    viewMode = mode === "capture" ? "capture" : "live";
    const live = viewMode === "live";
    $("liveModeButton").classList.toggle("active", live);
    $("captureModeButton").classList.toggle("active", !live);
    $("liveModeButton").setAttribute("aria-selected", String(live));
    $("captureModeButton").setAttribute("aria-selected", String(!live));
    $("captureCursorReadout").hidden = live || !captureRecord;
    $("phoneSource").hidden=!live;
    $("measurementSource").textContent = live
      ? "Live VGA window · all enabled channels · mean and peak envelope"
      : "Saved focus capture · acquisition timestamps and peak envelope";
    if (!live && captureRecord) renderCaptureMeta();
    drawNeeded = true;
    if (!live) pollCaptureStatus();
  }

  async function readCaptureResponse(response) {
    const text = await response.text();
    let body = text;
    try { body = text ? JSON.parse(text) : {}; } catch (_) {}
    if (!response.ok) {
      const detail = typeof body === "string" ? body : (body.error || body.message || response.statusText);
      throw new Error(detail || "HTTP " + response.status);
    }
    return body;
  }

  async function captureAction(path) {
    const response = await fetch(path, {method: "GET", cache: "no-store"});
    return readCaptureResponse(response);
  }

  function captureState(status) {
    return String(status && (status.state || status.status || (status.ready ? "ready" : "idle"))).toLowerCase();
  }

  function captureProgress(status) {
    if (!status) return "";
    const sent = Number(status.bytesSent || status.sentBytes || 0);
    const total = Number(status.bytesTotal || status.totalBytes || 0);
    const percent = Number(status.percent);
    if (total > 0) return " (" + sent.toLocaleString() + "/" + total.toLocaleString() + " bytes)";
    if (Number.isFinite(percent) && percent >= 0) return " (" + percent.toFixed(0) + "%)";
    return "";
  }

  async function pollCaptureStatus() {
    try {
      const response = await fetch("/api/capture/status", {cache: "no-store"});
      if (response.status === 404) {
        if (viewMode === "capture") setCapturePanelState("error", "Capture status endpoint is unavailable on this bridge.");
        return null;
      }
      const status = await readCaptureResponse(response);
      const state = captureState(status);
      const active = ["capturing", "armed", "running", "receiving", "transferring", "downloading"].includes(state);
      const ready = Boolean(status.dataReady || status.downloadable || status.captureReady ||
        status.complete || state === "ready" || state === "complete");
      setCapturePanelState(active ? "capturing" : state === "error" || state === "stopped" || (status.complete && status.valid === false) ? "error" : ready ? "ready" : "idle",
        status.message || status.detail || (state === "stopped" ? "Capture stopped before a complete validated record was available." : active ? "FPGA capture in progress" + captureProgress(status) : undefined));
      renderCaptureMeta(status);
      if (viewMode === "capture" && active) {
        window.clearTimeout(captureStatusTimer);
        captureStatusTimer = window.setTimeout(pollCaptureStatus, 1200);
      }
      return status;
    } catch (error) {
      if (viewMode === "capture") setCapturePanelState("error", "Capture status: " + error.message);
      return null;
    }
  }

  function checkSnapshotGeneration(generation) {
    if (generation !== undefined && generation !== autoSnapshotGeneration) {
      throw new Error("Snapshot settings changed.");
    }
  }

  function invalidateWaveform(preserveRecord = false) {
    if(phoneSource==="raw"&&!preserveRecord)clearSamples();
    autoSnapshotGeneration++;
    if (!preserveRecord) captureRecord = null;
    if (!captureRecord) captureViewport = {
      startSec: 0, endSec: vgaWindowForTimebase(Number($("timebase").value)) || 1
    };
    drawNeeded = true;
    window.clearTimeout(autoSnapshotTimer);
    if ($("autoSnapshot").checked) scheduleAutoSnapshot(300);
  }

  async function waitForCaptureReady(initialStatus, generation) {
    const deadline = Date.now() + 120000;
    let status = initialStatus || null;
    while (Date.now() < deadline) {
      checkSnapshotGeneration(generation);
      const state = captureState(status);
      if (status && (status.dataReady || status.downloadable || status.captureReady ||
          status.complete || state === "ready" || state === "complete")) return status;
      if (state === "error") throw new Error(status.message || status.error || "Capture transfer failed.");
      const response = await fetch("/api/capture/status", {cache: "no-store"});
      if (response.status === 404) throw new Error("Capture status endpoint is unavailable on this bridge.");
      status = await readCaptureResponse(response);
      const nextState = captureState(status);
      if (nextState === "error") throw new Error(status.message || status.error || "Capture transfer failed.");
      setCapturePanelState("capturing", (status.message || "Waiting for complete FPGA record") + captureProgress(status));
      renderCaptureMeta(status);
      await new Promise(resolve => window.setTimeout(resolve, 1000));
    }
    throw new Error("Capture did not become downloadable within 120 seconds.");
  }

  async function waitForFpgaCapture(initialStatus, generation) {
    const snapshotDurationMs = generation === undefined ? 0 :
      selectedPhoneWindowMs() * 640 / CaptureProtocol.VGA_PLOT_SAMPLES;
    const deadline = Date.now() + Math.max(120000, snapshotDurationMs + 60000);
    let status = initialStatus || null;
    while (Date.now() < deadline) {
      checkSnapshotGeneration(generation);
      const state = captureState(status);
      if (status && (status.fpgaReady || status.dataReady || status.downloadable || status.complete)) return status;
      if (status && (state === "idle" || state === "error" || state === "stopped")) {
        throw new Error(state === "idle" ? "Arm a capture before downloading it." : (status.message || status.error || "FPGA capture failed."));
      }
      const response = await fetch("/api/capture/status", {cache: "no-store"});
      status = await readCaptureResponse(response);
      renderCaptureMeta(status);
      setCapturePanelState("capturing", status.fpgaReady ? "FPGA record is ready." : "Waiting for the FPGA trigger and record...");
      await new Promise(resolve => window.setTimeout(resolve, 750));
    }
    throw new Error("FPGA capture did not complete within its acquisition timeout.");
  }

  async function armTriggeredCapture() {
    if ($("autoSnapshot").checked) { $("autoSnapshot").checked = false; toggleAutoSnapshots(); }
    setViewMode("capture");
    setCapturePanelState("capturing", "Arming FPGA capture...");
    $("armCaptureButton").disabled = true;
    try {
      await captureAction("/api/capture/arm");
      captureRecord = null;
      resetCaptureViewport();
      setCapturePanelState("capturing", "FPGA capture armed; waiting for trigger.");
      renderCaptureMeta();
      pollCaptureStatus();
    } catch (error) {
      setCapturePanelState("error", "Arm failed: " + error.message);
    } finally {
      $("armCaptureButton").disabled = false;
    }
  }

  async function stopTriggeredCapture() {
    if ($("autoSnapshot").checked) { $("autoSnapshot").checked = false; toggleAutoSnapshots(); }
    setViewMode("capture");
    setCapturePanelState("capturing", "Requesting capture stop...");
    try {
      await captureAction("/api/capture/stop");
      setCapturePanelState("capturing", "Stop acknowledged; waiting for bridge to finalize the record.");
      pollCaptureStatus();
    } catch (error) {
      setCapturePanelState("error", "Stop failed: " + error.message);
    }
  }

  async function decodeCaptureResponse(response) {
    const contentType = response.headers.get("content-type") || "";
    if (!response.ok) return readCaptureResponse(response);
    if (contentType.includes("application/json")) return readCaptureResponse(response);
    return CaptureProtocol.decodeCapture(await response.arrayBuffer(), {fullScaleMv});
  }

  async function downloadTriggeredCapture() {
    if ($("autoSnapshot").checked) { $("autoSnapshot").checked = false; toggleAutoSnapshots(); }
    setViewMode("capture");
    setCapturePanelState("capturing", "Requesting FPGA record; this can take a while at 9600 baud.");
    $("downloadCaptureButton").disabled = true;
    try {
      const statusResponse = await fetch("/api/capture/status", {cache: "no-store"});
      const fpgaStatus = await waitForFpgaCapture(await readCaptureResponse(statusResponse));
      if (fpgaStatus.dataReady || fpgaStatus.downloadable || fpgaStatus.complete) {
        const dataResponse = await fetch("/api/capture/data", {cache: "no-store"});
        if (!dataResponse.ok) await readCaptureResponse(dataResponse);
        captureRecord = CaptureProtocol.decodeCapture(await dataResponse.arrayBuffer(), {fullScaleMv});
        resetCaptureViewport();
        renderCaptureMeta();
        setCapturePanelState("ready", "Complete FPGA record loaded.");
        drawNeeded = true;
        return;
      }
      const downloadResponse = await fetch("/api/capture/download", {cache: "no-store"});
      const contentType = downloadResponse.headers.get("content-type") || "";
      let downloadResult;
      if (contentType.includes("application/json")) {
        downloadResult = await readCaptureResponse(downloadResponse);
      } else {
        downloadResult = await decodeCaptureResponse(downloadResponse);
      }
      if (downloadResult && downloadResult.samples) {
        captureRecord = downloadResult;
      } else {
        const readyStatus = await waitForCaptureReady(downloadResult);
        const dataResponse = await fetch("/api/capture/data", {cache: "no-store"});
        if (!dataResponse.ok) await readCaptureResponse(dataResponse);
        captureRecord = CaptureProtocol.decodeCapture(await dataResponse.arrayBuffer(), {fullScaleMv});
        captureRecord.bridgeStatus = readyStatus;
        if (readyStatus.triggerMode !== undefined || readyStatus.mode !== undefined) captureRecord.triggerMode = readyStatus.triggerMode !== undefined ? readyStatus.triggerMode : readyStatus.mode;
        if (readyStatus.triggerLevel !== undefined) captureRecord.triggerLevel = readyStatus.triggerLevel;
        if (readyStatus.averaging !== undefined) captureRecord.averaging = readyStatus.averaging;
        if (readyStatus.configFingerprint !== undefined || readyStatus.configuration !== undefined) captureRecord.configFingerprint = readyStatus.configFingerprint !== undefined ? readyStatus.configFingerprint : readyStatus.configuration;
      }
      resetCaptureViewport();
      renderCaptureMeta();
      const quality = captureRecord.complete && captureRecord.metadataValid
        ? (captureRecord.hasGap ? "Downloaded with timestamp gap." : "Complete FPGA record downloaded.")
        : "Record metadata or completion flag is invalid; measurements are limited.";
      setCapturePanelState(captureRecord.complete && captureRecord.metadataValid ? "ready" : "error", quality);
      drawNeeded = true;
    } catch (error) {
      setCapturePanelState("error", "Download failed: " + error.message);
    } finally {
      $("downloadCaptureButton").disabled = false;
    }
  }

  function setSnapshotStatus(text, state) {
    const element = $("snapshotStatus");
    element.textContent = text;
    element.className = "muted" + (state ? " " + state : "");
  }

  async function takeManualSnapshot() {
    if(autoSnapshotRunning)return;
    if($("autoSnapshot").checked){$("autoSnapshot").checked=false;toggleAutoSnapshots();}
    const generation = autoSnapshotGeneration;
    autoSnapshotRunning=true;setViewMode("capture");
    $("manualSnapshotButton").disabled=true;$("mobileSnapshotButton").disabled=true;
    setCapturePanelState("capturing","Arming a VGA-sized FPGA snapshot...");
    setSnapshotStatus("Capturing 640 timestamped focus-channel samples...","good");
    try{
      const armed=await captureAction("/api/capture/snapshot");
      let ready=await waitForFpgaCapture(armed, generation);
      if(!(ready.dataReady||ready.downloadable||ready.complete)){
        setSnapshotStatus("FPGA snapshot ready; transferring it to the phone...","good");
        ready=await readCaptureResponse(await fetch("/api/capture/download",{cache:"no-store"}));
        ready=await waitForCaptureReady(ready, generation);
      }
      const dataResponse=await fetch("/api/capture/data",{cache:"no-store"});
      if(!dataResponse.ok)await readCaptureResponse(dataResponse);
      const record = CaptureProtocol.decodeCapture(await dataResponse.arrayBuffer(),{fullScaleMv});
      checkSnapshotGeneration(generation);
      captureRecord = record;
      captureRecord.bridgeStatus=ready;fitCaptureToVgaWindow();renderCaptureMeta();
      setCapturePanelState("ready","VGA-matched FPGA snapshot loaded.");
      setSnapshotStatus("Snapshot "+(captureRecord.captureId||"")+" is ready. Tap the plot for cursors or use Save image.","good");
      drawNeeded=true;
    }catch(error){
      if (generation === autoSnapshotGeneration) {
        setCapturePanelState("error","Snapshot failed: "+error.message);
        setSnapshotStatus("Snapshot error: "+error.message,"error");
      }
    }finally{
      autoSnapshotRunning=false;$("manualSnapshotButton").disabled=false;$("mobileSnapshotButton").disabled=false;
    }
  }

  function scheduleAutoSnapshot(delay) {
    window.clearTimeout(autoSnapshotTimer);
    if (!$("autoSnapshot").checked) return;
    const generation = autoSnapshotGeneration;
    autoSnapshotTimer = window.setTimeout(() => runAutoSnapshot(generation), delay);
  }

  async function runAutoSnapshot(generation) {
    if (autoSnapshotRunning || generation !== autoSnapshotGeneration || !$("autoSnapshot").checked) return;
    if (paused || !connected || !(measuredSampleCycles > 0) || settingsBusy || displayBusy) {
      scheduleAutoSnapshot(500);
      return;
    }
    autoSnapshotRunning = true;
    setViewMode("capture");
    setSnapshotStatus("Arming a timestamped FPGA snapshot...", "good");
    try {
      const armed = await captureAction("/api/capture/snapshot");
      const fpgaReady = await waitForFpgaCapture(armed, generation);
      if (generation !== autoSnapshotGeneration || !$("autoSnapshot").checked) return;
      let ready = fpgaReady;
      if (!(ready.dataReady || ready.downloadable || ready.complete)) {
        setSnapshotStatus("FPGA VGA record ready; transferring the short snapshot...", "good");
        ready = await readCaptureResponse(await fetch("/api/capture/download", {cache: "no-store"}));
        ready = await waitForCaptureReady(ready, generation);
      }
      if (generation !== autoSnapshotGeneration || !$("autoSnapshot").checked) return;
      const dataResponse = await fetch("/api/capture/data", {cache: "no-store"});
      if (!dataResponse.ok) await readCaptureResponse(dataResponse);
      const record = CaptureProtocol.decodeCapture(await dataResponse.arrayBuffer(), {fullScaleMv});
      checkSnapshotGeneration(generation);
      captureRecord = record;
      captureRecord.bridgeStatus = ready;
      fitCaptureToVgaWindow();
      renderCaptureMeta();
      setCapturePanelState("ready", "Automatic FPGA snapshot loaded.");
      setSnapshotStatus("Showing FPGA snapshot " + (captureRecord.captureId || "") + ". Next capture is scheduled.", "good");
      drawNeeded = true;
    } catch (error) {
      if (generation === autoSnapshotGeneration) {
        setCapturePanelState("error", "Automatic snapshot failed: " + error.message);
        setSnapshotStatus("Snapshot error: " + error.message, "error");
      }
    } finally {
      autoSnapshotRunning = false;
      if ($("autoSnapshot").checked) {
        scheduleAutoSnapshot(Number($("snapshotInterval").value) || 1500);
      }
    }
  }

  function toggleAutoSnapshots() {
    autoSnapshotGeneration++;
    window.clearTimeout(autoSnapshotTimer);
    if ($("autoSnapshot").checked) {
      setSnapshotStatus("Starting automatic FPGA snapshots. Only the focus channel is captured.", "good");
      setViewMode("capture");
      scheduleAutoSnapshot(0);
    } else {
      setSnapshotStatus("Automatic refresh off. The last FPGA waveform stays visible.");
    }
  }

  function exportCaptureCsv() {
    if (!captureRecord) {
      setCapturePanelState("error", "Download a triggered record before exporting it.");
      return;
    }
    const csv = CaptureProtocol.csvForCapture(captureRecord, captureViewport);
    const blob = new Blob([csv], {type: "text/csv"});
    const url = URL.createObjectURL(blob);
    const link = document.createElement("a");
    link.href = url;
    link.download = "fpga-oscilloscope-capture-" + (captureRecord.captureId || "record") + ".csv";
    link.click();
    window.setTimeout(() => URL.revokeObjectURL(url), 1000);
  }

  function capturePointerTime(clientX) {
    const rect = canvas.getBoundingClientRect();
    const pixelScale = rect.width / canvas.width * Math.min(window.devicePixelRatio || 1, 2);
    const fraction = Math.max(0, Math.min(1, (clientX - rect.left - 66 * pixelScale) / (rect.width - 84 * pixelScale)));
    return captureViewport.startSec + fraction * (captureViewport.endSec - captureViewport.startSec);
  }

  function captureXForTime(timeSec, width) {
    const span = captureViewport.endSec - captureViewport.startSec;
    return span > 0 ? (timeSec - captureViewport.startSec) * width / span : 0;
  }

  function setCaptureCursor(timeSec) {
    if (captureCursorA === null || (captureCursorA !== null && captureCursorB !== null)) captureCursorA = timeSec;
    else captureCursorB = timeSec;
    drawNeeded = true;
  }

  function updateCaptureMeasurements() {
    if (!captureRecord) {
      ["minText", "maxText", "ppText", "avgText", "rmsText"].forEach(id => $(id).textContent = "--");
      $("frequencyText").textContent = "-- Hz";
      $("periodText").textContent = "--";
      $("dutyText").textContent = "-- %";
      $("measurementSource").textContent = "Waiting for an FPGA waveform. Automatic snapshots follow the VGA settings.";
      $("channelAnalysisBody").innerHTML = '<tr><td colspan="8">No FPGA capture loaded.</td></tr>';
      updateCaptureCursorReadout(null);
      return null;
    }
    const measurement = CaptureProtocol.measureRecord(captureRecord, captureViewport);
    const invalid = value => value === null || value === undefined || !Number.isFinite(value);
    $("minText").textContent = measurement.valid ? formatCaptureVolts(measurement.min) : "--";
    $("maxText").textContent = measurement.valid ? formatCaptureVolts(measurement.max) : "--";
    $("ppText").textContent = measurement.valid ? formatCaptureVolts(measurement.peakToPeak) : "--";
    $("avgText").textContent = measurement.valid ? formatCaptureVolts(measurement.average) : "--";
    $("rmsText").textContent = measurement.valid ? formatCaptureVolts(measurement.rms) : "--";
    $("frequencyText").textContent = invalid(measurement.frequencyHz) ? "-- Hz" : formatFrequencyHz(measurement.frequencyHz);
    $("periodText").textContent = invalid(measurement.periodSec) ? "--" : formatPeriodSeconds(measurement.periodSec);
    $("dutyText").textContent = invalid(measurement.dutyPercent) ? "-- %" : measurement.dutyPercent.toFixed(1) + " %";
    $("measurementSource").textContent = measurement.reason
      ? "FPGA timestamps; " + measurement.reason
      : recordMeasurementSource();
    const channel=captureRecord.focusChannel,color=TRACE_COLORS[channel]||TRACE_COLORS[0];
    const show=value=>measurement.valid&&value!==null?formatCaptureVolts(value):"--";
    const visibleLast=captureRecord.validSamples.reduce((last,sample)=>sample.timeSec>=captureViewport.startSec&&sample.timeSec<=captureViewport.endSec?sample:last,null);
    $("channelAnalysisBody").innerHTML=`<tr class="focus"><td><span class="channel-key" style="--channel:${color}">CH${channel}</span><span class="focus-tag">FPGA CAPTURE</span></td>`+
      `<td>${visibleLast?formatCaptureVolts(visibleLast.adc):"--"}</td>`+
      `<td>${show(measurement.min)}</td><td>${show(measurement.max)}</td><td>${show(measurement.peakToPeak)}</td><td>${show(measurement.average)}</td><td>${show(measurement.rms)}</td>`+
      `<td>${measurement.frequencyHz?measurement.frequencyHz.toFixed(3)+" Hz":"--"}</td></tr>`;
    updateCaptureCursorReadout(measurement);
    return measurement;
  }

  function recordMeasurementSource() {
    return captureRecord.envelope
      ? "FPGA snapshot: mean trace with min/max envelope. Average and RMS use column means."
      : "FPGA capture: measurements use acquisition timestamps and valid samples.";
  }

  function drawCaptureScope() {
    resizeCanvas();
    const w = canvas.width, h = canvas.height, dpr = Math.min(window.devicePixelRatio || 1, 2);
    const left = 66 * dpr, right = 18 * dpr, top = 56 * dpr, bottom = 38 * dpr;
    const plotW = w - left - right, plotH = h - top - bottom;
    ctx.fillStyle = "#03070b"; ctx.fillRect(0, 0, w, h);
    ctx.lineWidth = 1; ctx.strokeStyle = "#172738"; ctx.beginPath();
    for (let x = 0; x <= 10; x++) { const px = left + plotW * x / 10; ctx.moveTo(px, top); ctx.lineTo(px, top + plotH); }
    for (let y = 0; y <= 8; y++) { const py = top + plotH * y / 8; ctx.moveTo(left, py); ctx.lineTo(left + plotW, py); }
    if ($("gridEnable").checked) ctx.stroke();
    const record = captureRecord;
    const span = captureViewport.endSec - captureViewport.startSec;
    let min = ADC_MAX, max = 0;
    const visible = record ? record.samples.filter(sample =>
      sample.valid && sample.timeSec >= captureViewport.startSec && sample.timeSec <= captureViewport.endSec) : [];
    for (const sample of visible) { min = Math.min(min, sample.low); max = Math.max(max, sample.high); }
    if (!visible.length) { min = 0; max = ADC_MAX; }
    const scale = 1 << Number($("vertical").value);
    const center = 2048 + (Number($("verticalPosition").value) - 50) * 32;
    const yMin = center - 2048 / scale, yMax = center + 2048 / scale;
    const yOf = value => top + plotH - (value - yMin) * plotH / (yMax - yMin);
    ctx.strokeStyle = "#2b455d"; ctx.beginPath();
    ctx.moveTo(left, top + plotH / 2); ctx.lineTo(left + plotW, top + plotH / 2);
    ctx.moveTo(left + plotW / 2, top); ctx.lineTo(left + plotW / 2, top + plotH); ctx.stroke();
    ctx.font = "500 " + String(12 * dpr) + "px ui-monospace,monospace"; ctx.fillStyle = "#c4d4e5"; ctx.textAlign = "right";
    for (let y = 0; y <= 4; y++) {
      const raw = yMax - (yMax - yMin) * y / 4;
      ctx.fillText(CaptureProtocol.valueToVolts(raw, record ? record.fullScaleMv : fullScaleMv).toFixed(2) + "V", left - 6 * dpr, top + plotH * y / 4 + 3 * dpr);
    }
    const triggerSample = record && record.triggered && record.triggerMode !== 0 && Number.isInteger(record.triggerIndex)
      ? record.samples[record.triggerIndex] : null;
    const axisOrigin = triggerSample ? triggerSample.timeSec : captureViewport.startSec;
    const timeTicks=plotW/dpr<500?4:8;
    for (let x = 0; x <= timeTicks; x++) {
      ctx.textAlign=x===0?"left":x===timeTicks?"right":"center";
      const t = captureViewport.startSec + span * x / timeTicks;
      ctx.fillText(formatAxisTime(t - axisOrigin), left + plotW * x / timeTicks, h - 12 * dpr);
    }
    updateXAxisReadout(span);
    if (record) {
      if (triggerSample && triggerSample.timeSec >= captureViewport.startSec && triggerSample.timeSec <= captureViewport.endSec) {
        const triggerX = left + captureXForTime(triggerSample.timeSec, plotW);
        ctx.setLineDash([4 * dpr, 5 * dpr]); ctx.strokeStyle = "#ffc85788";
        ctx.beginPath(); ctx.moveTo(triggerX, top); ctx.lineTo(triggerX, top + plotH); ctx.stroke(); ctx.setLineDash([]);
      }
      ctx.strokeStyle = TRACE_COLORS[record.focusChannel] || TRACE_COLORS[0];
      ctx.lineWidth = 1.7 * dpr;
      ctx.save();
      ctx.beginPath(); ctx.rect(left, top, plotW, plotH); ctx.clip();
      const pixelColumns = Math.max(1, Math.floor(plotW / dpr));
      const dense = visible.length > pixelColumns * 1.5;
      if (record.envelope && !dense) {
        ctx.globalAlpha = 0.25;
        ctx.lineWidth = dpr;
        ctx.beginPath();
        for (const sample of visible) {
          const x = left + captureXForTime(sample.timeSec, plotW);
          ctx.moveTo(x, yOf(sample.low)); ctx.lineTo(x, yOf(sample.high));
        }
        ctx.stroke();
        ctx.globalAlpha = 1;
      }
      if (!dense) {
        ctx.lineWidth = 1.7 * dpr;
        ctx.beginPath();
        let started = false;
        let previous = null;
        for (const sample of visible) {
          const x = left + captureXForTime(sample.timeSec, plotW);
          const y = yOf(sample.adc);
          if (!started || (previous && sample.ticks - previous.ticks > record.expectedTicks * 1.5)) {
            ctx.moveTo(x, y); started = true;
          } else ctx.lineTo(x, y);
          previous = sample;
        }
        ctx.stroke();
      } else {
        const bucketMin = new Float32Array(pixelColumns), bucketMax = new Float32Array(pixelColumns);
        const bucketSum = new Float64Array(pixelColumns), bucketCount = new Uint32Array(pixelColumns);
        bucketMin.fill(Infinity); bucketMax.fill(-Infinity);
        for (const sample of visible) {
          const column = Math.max(0, Math.min(pixelColumns - 1,
            Math.floor((sample.timeSec - captureViewport.startSec) * pixelColumns / span)));
          bucketMin[column] = Math.min(bucketMin[column], sample.low);
          bucketMax[column] = Math.max(bucketMax[column], sample.high);
          bucketSum[column] += sample.adc;
          bucketCount[column]++;
        }
        ctx.globalAlpha = 0.25;
        ctx.lineWidth = dpr;
        ctx.beginPath();
        for (let column = 0; column < pixelColumns; column++) {
          if (bucketMin[column] === Infinity) continue;
          const x = left + (column + 0.5) * dpr;
          ctx.moveTo(x, yOf(bucketMax[column]));
          ctx.lineTo(x, yOf(bucketMin[column]));
        }
        ctx.stroke();
        ctx.globalAlpha = 1;
        ctx.lineWidth = 1.7 * dpr;
        ctx.beginPath();
        let previousColumn = -2;
        for (let column = 0; column < pixelColumns; column++) {
          if (!bucketCount[column]) continue;
          const x = left + (column + 0.5) * dpr;
          const y = yOf(bucketSum[column] / bucketCount[column]);
          if (column === previousColumn + 1) ctx.lineTo(x, y);
          else ctx.moveTo(x, y);
          previousColumn = column;
        }
        ctx.stroke();
      }
      ctx.restore();
      for (const gap of record.gaps) {
        const sample = record.samples[gap.after];
        if (!sample || sample.timeSec < captureViewport.startSec || sample.timeSec > captureViewport.endSec) continue;
        const x = left + captureXForTime(sample.timeSec, plotW);
        ctx.setLineDash([3 * dpr, 4 * dpr]); ctx.strokeStyle = "#ff6474aa";
        ctx.beginPath(); ctx.moveTo(x, top); ctx.lineTo(x, top + plotH); ctx.stroke(); ctx.setLineDash([]);
      }
      for (const [cursor, color, label] of [[captureCursorA, "#35e5ff", "A"], [captureCursorB, "#ffc857", "B"]]) {
        if (cursor === null || cursor < captureViewport.startSec || cursor > captureViewport.endSec) continue;
        const x = left + captureXForTime(cursor, plotW);
        ctx.setLineDash([5 * dpr, 4 * dpr]); ctx.strokeStyle = color; ctx.beginPath();
        ctx.moveTo(x, top); ctx.lineTo(x, top + plotH); ctx.stroke(); ctx.setLineDash([]);
        ctx.fillStyle = color; ctx.textAlign = "center"; ctx.fillText(label + " " + formatCaptureDuration(cursor), x, top + 12 * dpr);
      }
    }
    $("traceLegend").innerHTML = record
      ? "<span class=\"trace-chip\" style=\"color:" + (TRACE_COLORS[record.focusChannel] || TRACE_COLORS[0]) + "\">CH" + record.focusChannel + " FPGA CAPTURE</span>"
      : "<span class=\"trace-chip\">No capture loaded</span>";
    $("triggerText").textContent = record ? (record.triggerMode === 0 ? "FREE" : record.triggered ? "TRIGGERED" : "CAPTURE") : "WAITING";
    $("voltageText").textContent = record && visible.length ? "CH" + record.focusChannel + "  " + formatCaptureVolts(visible[visible.length - 1].adc) : "-- V";
    $("rawText").textContent = record && visible.length ? "FPGA tick " + (visible[visible.length - 1].tick >>> 0) : "No valid sample";
    updateCaptureMeasurements();
  }
  function animationFrame() { if(drawNeeded){drawScope();drawNeeded=false;} requestAnimationFrame(animationFrame); }

  function clampInput(element, maximum) {
    const value = Math.round(Number(element.value));
    if (!Number.isFinite(value)) throw new Error("Enter a numeric value.");
    const result = Math.max(0,Math.min(maximum,value)); element.value=result; return result;
  }

  let settingsBusy=false, settingsAgain=false;
  async function applySettings() {
    if(manualMode)return;
    updateChannelButtons();
    if(settingsBusy){settingsAgain=true;return;}
    invalidateWaveform();
    const button=$("applyButton"), status=$("commandStatus");
    settingsBusy=true;button.disabled=true;
    do {
      settingsAgain=false;
      try {
        const ch=clampInput($("channel"),5);
        const focusCheck=document.querySelector(`.channel-check[value="${ch}"]`);focusCheck.checked=true;
        const mask=channelMask(),selected=enabledChannels();
        status.className="command-status";status.textContent=`Starting ${selected.length}-channel acquisition...`;
        const response=await fetch(`/api/channels?mask=${mask}&focus=${ch}&value=0`,{cache:"no-store"});
        const text=await response.text(); if(!response.ok)throw new Error(text||`HTTP ${response.status}`);
        $("channelTitle").textContent=selected.length>1?selected.join("/"):ch;
        $("enabledLive").textContent=selected.map(channel=>"CH"+channel).join("/");
        status.className="command-status good";status.textContent=`Comparing ${selected.map(channel=>"CH"+channel).join(", ")}; CH${ch} is the measurement focus.`;

      } catch(error) { status.className="command-status error";status.textContent=error.message; }
    } while(settingsAgain);
    settingsBusy=false;button.disabled=false;
  }

  let displayBusy=false, displayAgain=false;
  async function applyDisplaySettings(preserveRecord = false) {
    if(displayBusy){displayAgain=true;return;}
    invalidateWaveform(preserveRecord === true);
    displayBusy=true;
    do {
      displayAgain=false;
      const mode={free:0,rising:1,falling:2,auto:3}[$("triggerMode").value];
      const query=new URLSearchParams({
        tb:$("timebase").value,scale:$("vertical").value,
        pos:$("verticalPosition").value,trig:String(mode),
        level:$("triggerLevel").value,grid:$("gridEnable").checked?"1":"0",
        run:paused?"0":"1",tpos:$("triggerPosition").value,
        single:$("singleShot").checked?"1":"0",avg:$("acquisitionAverage").value,
        stable:$("stabilizeWave").checked?"1":"0"
      });
      try {
        const response=await fetch(`/api/display?${query}`,{cache:"no-store"});
        const text=await response.text();if(!response.ok)throw new Error(text||`HTTP ${response.status}`);
      } catch(error) {
        const status=$("commandStatus");status.className="command-status error";
        status.textContent="VGA setting failed: "+error.message;
      }
    } while(displayAgain);
    displayBusy=false;
  }

  async function rearmCapture(){
    paused=true;await applyDisplaySettings();paused=false;await applyDisplaySettings();
    $("pauseButton").textContent="Pause";$("runBadge").textContent="RUN";$("runBadge").classList.remove("paused");
  }

  function autoSetup(){
    const samples=[];
    if (captureRecord && captureRecord.focusChannel === Number($("channel").value)) {
      for (const sample of captureRecord.validSamples) {
        if (sample.timeSec >= captureViewport.startSec && sample.timeSec <= captureViewport.endSec) {
          samples.push({v: sample.adc, t: sample.timeMs});
        }
      }
    } else {
      const trace = traces[Number($("channel").value)], count = trace.count;
      const newest = count ? trace.times[indexAt(trace,count-1)] : 0;
      const windowStart = newest - selectedPhoneWindowMs();
      for(let i=0;i<count;i++){const j=indexAt(trace,i);if(trace.times[j]>=windowStart)samples.push({v:trace.values[j],t:trace.times[j]});}
    }
    if(samples.length<24){const status=$("commandStatus");status.className="command-status error";status.textContent="Auto setup needs at least 24 focus-channel samples.";return;}
    const sorted=samples.map(sample=>sample.v).sort((a,b)=>a-b);
    const low=sorted[Math.floor((sorted.length-1)*0.02)],high=sorted[Math.ceil((sorted.length-1)*0.98)];
    const span=Math.max(16,high-low),center=Math.round((low+high)/2);
    const armLevel=center-span*0.08,fireLevel=center+span*0.08,crossings=[];let armed=false;
    for(const sample of samples){if(sample.v<=armLevel)armed=true;else if(armed&&sample.v>=fireLevel){crossings.push(sample.t);armed=false;}}
    let period=0;
    if(crossings.length>=3){const periods=[];for(let i=1;i<crossings.length;i++)periods.push(crossings[i]-crossings[i-1]);periods.sort((a,b)=>a-b);const median=periods[Math.floor(periods.length/2)];const valid=periods.filter(value=>value>median*0.65&&value<median*1.35);if(valid.length)period=valid.reduce((a,b)=>a+b,0)/valid.length;}
    let scale=0;for(let candidate=1;candidate<=3;candidate++)if(span<0.70*(4096>>candidate))scale=candidate;
    const position=Math.max(0,Math.min(100,Math.round(50+(center-2048)/32)));
    $("vertical").value=String(scale);updateScaleLabels();$("verticalPosition").value=String(position);$("positionValue").textContent=position+"%";
    const level=Math.max(0,Math.min(4095,center));$("triggerLevel").value=String(level);$("triggerValue").textContent=formatVolts(level);$("triggerMode").value="auto";$("stabilizeWave").checked=true;
    if(period>0){
      if(measuredSampleCycles>0)setVgaTimebaseForWindow(Math.min(1,period*3/1000));
    }
    paused=false;$("pauseButton").textContent="Pause";$("mobileRunButton").textContent="Pause";$("runBadge").textContent="RUN";$("runBadge").classList.remove("paused");drawNeeded=true;applyDisplaySettings();
    const status=$("commandStatus");status.className="command-status good";status.textContent=period>0?`Auto setup: ${(1000/period).toFixed(2)} Hz, three cycles across the VGA plot.`:"Amplitude and center set; no repeating period detected.";
  }

  async function applyGenerator(number){
    const unit=$("gen"+number+"Unit").value,scale={Hz:1,kHz:1000,MHz:1000000}[unit];
    let frequency;
    try{frequency=CaptureProtocol.frequencyToHertz($("gen"+number+"Frequency").value,unit);}catch(error){const status=$("commandStatus");status.className="command-status error";status.textContent=error.message;return;}
    const duty=clampInput($("gen"+number+"Duty"),100),enable=$("gen"+number+"Enable").checked;
    $("gen"+number+"Frequency").value=String(Number((frequency/scale).toPrecision(7)));
    try{const response=await fetch(`/api/generator?ch=${number-1}&freq=${frequency}&duty=${duty}&enable=${enable?1:0}`,{cache:"no-store"});const text=await response.text();if(!response.ok)throw new Error(text||`HTTP ${response.status}`);const status=$("commandStatus");status.className="command-status good";status.textContent=`GPIO[${number===1?28:30}] ${enable?"ON":"OFF"}: ${Number((frequency/scale).toPrecision(7))} ${unit}, ${duty}% duty.`;}
    catch(error){const status=$("commandStatus");status.className="command-status error";status.textContent="Generator failed: "+error.message;}
  }

  function formatGeneratorActual(number,hertz,duty,enabled){
    if(!enabled)return `GPIO[${number===1?28:30}] OFF`;
    const unit=$("gen"+number+"Unit").value,scale={Hz:1,kHz:1000,MHz:1000000}[unit];
    return `GPIO[${number===1?28:30}]: ${Number((hertz/scale).toPrecision(7))} ${unit} · ${duty}%`;
  }

  async function applyCalibration() {
    const button=$("calibrateButton"),status=$("commandStatus");
    try {
      button.disabled=true;
      const mv=clampInput($("fullScaleMv"),9999);
      if(mv<1000)throw new Error("Full scale must be 1000-9999 mV.");
      const response=await fetch(`/api/calibration?mv=${mv}`,{cache:"no-store"});
      const text=await response.text();if(!response.ok)throw new Error(text||`HTTP ${response.status}`);
      fullScaleMv=mv;invalidateWaveform();updateScaleLabels();drawNeeded=true;
      $("triggerValue").textContent=formatVolts(Number($("triggerLevel").value));
      status.className="command-status good";status.textContent=`Voltage full scale set to ${(mv/1000).toFixed(3)} V.`;
    }catch(error){status.className="command-status error";status.textContent=error.message;}
    finally{button.disabled=false;}
  }

  function updateScaleLabels(){
    const scale=Math.max(0,Math.min(3,Math.round(Number($("vertical").value)||0)));
    $("vertical").value=String(scale);
    const mv=fullScaleMv/(8*(1<<scale));
    const voltageLabel = value => value>=1000 ? `${Number((value/1000).toFixed(4))} V/div`
      : `${Number(value.toFixed(3))} mV/div`;
    $("verticalScaleValue").textContent=voltageLabel(mv);
    const select=$("voltsPerDiv");
    if(select.children.length!==4)select.replaceChildren(...Array.from({length:4},(_,index)=>{
      const option=document.createElement("option");option.value=String(index);return option;
    }));
    if(document.activeElement!==select)Array.from(select.children).forEach((option,index)=>{
      const label=voltageLabel(fullScaleMv/(8*(1<<index)));
      if(option.textContent!==label)option.textContent=label;
    });
    if(select.value!==String(scale))select.value=String(scale);
  }

  function exportCsv() {
    const enabled=enabledChannels();let origin=Infinity,rows=[];
    for(const ch of enabled){const trace=traces[ch];if(trace.count)origin=Math.min(origin,trace.times[indexAt(trace,0)]);}
    if(!Number.isFinite(origin))return;
    for(const ch of enabled){const trace=traces[ch];for(let i=0;i<trace.count;i++){const j=indexAt(trace,i);rows.push([trace.times[j],ch,trace.values[j],trace.lows[j],trace.highs[j]]);}}
    rows.sort((a,b)=>a[0]-b[0]);let csv="time_ms,channel,adc,low,high,volts\n";
    for(const row of rows)csv+=(row[0]-origin).toFixed(6)+","+row[1]+","+row[2]+","+row[3]+","+row[4]+","+volts(row[2]).toFixed(5)+"\n";
    const blob=new Blob([csv],{type:"text/csv"}),url=URL.createObjectURL(blob),a=document.createElement("a");
    a.href=url;a.download=`scope-channels-${enabled.join("-")}.csv`;a.click();setTimeout(()=>URL.revokeObjectURL(url),1000);
  }

  async function saveScopeImage(){
    drawScope();
    const ratio=Math.min(window.devicePixelRatio||1,2),header=Math.round(76*ratio),footer=Math.round(62*ratio);
    const output=document.createElement("canvas");output.width=canvas.width;output.height=canvas.height+header+footer;
    const out=output.getContext("2d",{alpha:false});
    out.fillStyle="#07101a";out.fillRect(0,0,output.width,output.height);
    out.fillStyle="#e5edf5";out.font=`700 ${18*ratio}px ui-monospace,monospace`;out.fillText("FPGA Oscilloscope",16*ratio,27*ratio);
    out.fillStyle="#8495a9";out.font=`${11*ratio}px ui-monospace,monospace`;
    const focus=Number($("channel").value),channels=enabledChannels().map(ch=>"CH"+ch).join(", ");
    out.fillText(`${viewMode==="capture"?"FPGA capture":"Live monitor"} | Focus CH${focus} | ${channels||"No channels"}`,16*ratio,48*ratio);
    out.fillText(`${$("xAxisReadout").textContent} | ${new Date().toLocaleString()}`,16*ratio,65*ratio);
    out.drawImage(canvas,0,header);
    out.fillStyle="#e5edf5";out.font=`700 ${11*ratio}px ui-monospace,monospace`;
    out.fillText(`MIN ${$("minText").textContent}   MAX ${$("maxText").textContent}   P-P ${$("ppText").textContent}   AVG ${$("avgText").textContent}`,16*ratio,header+canvas.height+25*ratio);
    out.fillText(`RMS ${$("rmsText").textContent}   FREQ ${$("frequencyText").textContent}   PERIOD ${$("periodText").textContent}   DUTY ${$("dutyText").textContent}`,16*ratio,header+canvas.height+47*ratio);
    const blob=await new Promise(resolve=>output.toBlob(resolve,"image/png"));
    if(!blob)throw new Error("This browser could not create the scope image.");
    const stamp=new Date().toISOString().replace(/[:.]/g,"-");
    const file=new File([blob],`fpga-oscilloscope-${stamp}.png`,{type:"image/png"});
    if(navigator.share&&navigator.canShare&&navigator.canShare({files:[file]})){
      try{await navigator.share({files:[file],title:"FPGA Oscilloscope snapshot"});return;}catch(error){if(error&&error.name==="AbortError")return;}
    }
    const url=URL.createObjectURL(blob),link=document.createElement("a");link.href=url;link.download=file.name;link.click();setTimeout(()=>URL.revokeObjectURL(url),1000);
  }

  function zoomCapture(factor, centerSec) {
    if(viewMode!=="capture"||!captureRecord)return;
    const span=captureViewport.endSec-captureViewport.startSec,duration=captureRecord.durationSec||span;
    const minimum=Math.max(1e-9,(captureRecord.expectedTicks||1)/(captureRecord.clockHz||50000000));
    const nextSpan=Math.max(Math.min(duration,span*factor),minimum);
    const center=Number.isFinite(centerSec)?centerSec:captureViewport.startSec+span/2;
    const fraction=span>0?(center-captureViewport.startSec)/span:0.5;
    const nextStart=Math.max(0,Math.min(Math.max(0,duration-nextSpan),center-fraction*nextSpan));
    captureViewport={startSec:nextStart,endSec:nextStart+nextSpan};drawNeeded=true;
  }

  function togglePause(){
    paused=!paused;
    const label=paused?"Resume":"Pause";
    $("pauseButton").textContent=label;$("mobileRunButton").textContent=label;
    $("runBadge").textContent=paused?"HOLD":"RUN";$("runBadge").classList.toggle("paused",paused);applyDisplaySettings(paused);
  }

  const source = new EventSource("/events");
  function markConnected(){lastNetworkAt=performance.now();connected=true;setPill($("wifiPill"),"ok","Pico W connected");}
  source.onopen=markConnected;
  source.onerror=()=>{
    if(!lastNetworkAt||performance.now()-lastNetworkAt>2500){connected=false;setPill($("wifiPill"),"bad","Reconnecting...");}
  };
  source.onmessage=event=>{
    try {
      const d=JSON.parse(event.data);lastEventAt=performance.now();
      markConnected();
      if(Number.isFinite(d.pc)&&d.pc>0){
        measuredSampleCycles=d.pc;
        if(!labeledSampleCycles||Math.abs(measuredSampleCycles-labeledSampleCycles)>Math.max(2,labeledSampleCycles*0.005)){labeledSampleCycles=measuredSampleCycles;updateVgaTimeControl(false);}
      }
      setPill($("uartPill"),d.fresh?"ok":"",""+(d.fresh?"FPGA streaming":"Waiting for FPGA"));
      $("rateText").textContent=(d.pps>=1000?(d.pps/1000).toFixed(1)+"k":d.pps)+" pkt/s";$("packetsText").textContent=d.packets.toLocaleString();
      $("commandsText").textContent=d.cmds.toLocaleString();
      $("errorsText").textContent=d.errors;$("uptimeText").textContent=Math.floor(d.uptime/1000)+" s";
      $("baudText").textContent=d.baud.toLocaleString();$("footerBaud").textContent=d.baud.toLocaleString()+" baud";
      $("gen1Actual").textContent=formatGeneratorActual(1,d.g0hz,d.g0d,d.g0e);
      $("gen2Actual").textContent=formatGeneratorActual(2,d.g1hz,d.g1d,d.g1e);
      $("channelLive").textContent="CH"+$("channel").value;
      const focus=Number($("channel").value),focusRaw=Array.isArray(d.av)?d.av[focus]:d.latest;
      if((d.vm&(1<<focus))&&!(phoneSource==="raw"&&paused)){$("voltageText").textContent=`CH${focus}  ${formatVolts(focusRaw)}`;$("rawText").textContent="ADC "+pad4(focusRaw);}
      if(Array.isArray(d.av))for(let ch=0;ch<3;ch++){
        const active=Boolean(d.vm&(1<<ch)),pair=$("hexCh"+ch),readout=$("previewCh"+ch);
        pair.classList.toggle("disabled",!active);
        readout.textContent=active&&Number.isFinite(d.av[ch])?volts(d.av[ch]).toFixed(1)+" V":"--";
      }
      // Do not overwrite the channel select here. Data arrives about every
      // 40 ms and used to force the control back before Apply could be tapped.
      const selected=enabledChannels();$("channelTitle").textContent=selected.join("/");$("enabledLive").textContent=selected.map(channel=>"CH"+channel).join("/");
      if(phoneSource==="raw"&&viewMode==="live"&&Array.isArray(d.raw))appendRawBatch(d);
    } catch(error) { console.warn("Bad scope event",error); }
  };


  $("liveModeButton").addEventListener("click", () => {
    if ($("autoSnapshot").checked) { $("autoSnapshot").checked = false; toggleAutoSnapshots(); }
    setViewMode("live");
    // Leave a waiting/deep capture so it cannot occupy the live UART stream.
    captureAction("/api/capture/stop").catch(error=>{
      $("commandStatus").textContent="Could not stop saved capture: "+error.message;
    });
  });
  $("captureModeButton").addEventListener("click", () => setViewMode("capture"));
  $("armCaptureButton").addEventListener("click", armTriggeredCapture);
  $("stopCaptureButton").addEventListener("click", stopTriggeredCapture);
  $("downloadCaptureButton").addEventListener("click", downloadTriggeredCapture);
  $("manualSnapshotButton").addEventListener("click",takeManualSnapshot);
  $("mobileSnapshotButton").addEventListener("click",takeManualSnapshot);
  $("exportCaptureButton").addEventListener("click", exportCaptureCsv);
  $("resetCaptureViewButton").addEventListener("click", resetCaptureViewport);
  $("autoSnapshot").addEventListener("change", toggleAutoSnapshots);
  $("snapshotInterval").addEventListener("change", () => {
    if ($("autoSnapshot").checked && !autoSnapshotRunning) scheduleAutoSnapshot(0);
  });

  canvas.addEventListener("pointerdown", event => {
    if (viewMode !== "capture" || !captureRecord) return;
    canvas.setPointerCapture(event.pointerId);
    const time = capturePointerTime(event.clientX);
    const span = captureViewport.endSec - captureViewport.startSec;
    const cursorDistance = Math.max(span * 0.03, 0.000001);
    const nearA = captureCursorA !== null && Math.abs(time - captureCursorA) <= cursorDistance;
    const nearB = captureCursorB !== null && Math.abs(time - captureCursorB) <= cursorDistance;
    pointerState = {id: event.pointerId, mode: nearA ? "cursorA" : nearB ? "cursorB" : "pan", startX: event.clientX, startStart: captureViewport.startSec, startEnd: captureViewport.endSec};
    if (pointerState.mode === "pan") event.preventDefault();
  });
  canvas.addEventListener("pointermove", event => {
    if (!pointerState || pointerState.id !== event.pointerId || viewMode !== "capture") return;
    const rect = canvas.getBoundingClientRect();
    const span = pointerState.startEnd - pointerState.startStart;
    if (pointerState.mode === "cursorA" || pointerState.mode === "cursorB") {
      const time = capturePointerTime(event.clientX);
      if (pointerState.mode === "cursorA") captureCursorA = time; else captureCursorB = time;
    } else {
      const shift = (event.clientX - pointerState.startX) / rect.width * span;
      const duration = captureRecord ? captureRecord.durationSec : pointerState.startEnd;
      const nextStart = Math.max(0, Math.min(Math.max(0, duration - span), pointerState.startStart - shift));
      captureViewport.startSec = nextStart;
      captureViewport.endSec = nextStart + span;
    }
    drawNeeded = true;
    event.preventDefault();
  });
  canvas.addEventListener("pointerup", event => {
    if (!pointerState || pointerState.id !== event.pointerId) return;
    if (pointerState.mode === "pan" && Math.abs(event.clientX - pointerState.startX) < 5) setCaptureCursor(capturePointerTime(event.clientX));
    pointerState = null;
    if (canvas.hasPointerCapture(event.pointerId)) canvas.releasePointerCapture(event.pointerId);
  });
  canvas.addEventListener("pointercancel", () => { pointerState = null; });
  canvas.addEventListener("wheel", event => {
    if (viewMode !== "capture" || !captureRecord) return;
    event.preventDefault();
    const factor = event.deltaY < 0 ? 0.8 : 1.25;
    zoomCapture(factor,capturePointerTime(event.clientX));
  }, {passive: false});

  $("applyButton").addEventListener("click",applySettings);
  $("snapshotSourceButton").addEventListener("click",()=>setPhoneSource("snapshot"));
  $("rawSourceButton").addEventListener("click",()=>setPhoneSource("raw"));
  $("autoButton").addEventListener("click",autoSetup);
  $("channel").addEventListener("change",()=>{
    if(manualMode)return;
    document.querySelector(`.channel-check[value="${$("channel").value}"]`).checked=true;
    applySettings();
  });
  document.querySelectorAll(".channel-check").forEach(input=>input.addEventListener("change",()=>{
    if(!channelMask()){input.checked=true;const status=$("commandStatus");status.className="command-status error";status.textContent="Keep at least one channel enabled.";return;}
    if (!document.querySelector(`.channel-check[value="${$("channel").value}"]`).checked)
      $("channel").value=String(enabledChannels()[0]);
    applySettings();
  }));
  $("pauseButton").addEventListener("click",togglePause);
  $("mobileRunButton").addEventListener("click",togglePause);
  $("mobileAutoButton").addEventListener("click",autoSetup);
  const imageAction=()=>saveScopeImage().catch(error=>{const status=$("commandStatus");status.className="command-status error";status.textContent="Image export failed: "+error.message;});
  $("saveImageButton").addEventListener("click",imageAction);
  $("mobileImageButton").addEventListener("click",imageAction);
  $("captureZoomInButton").addEventListener("click",()=>zoomCapture(0.5));
  $("captureZoomOutButton").addEventListener("click",()=>zoomCapture(2));
  $("clearButton").addEventListener("click",()=>{clearSamples();invalidateWaveform();});
  $("exportButton").addEventListener("click",exportCsv);
  $("calibrateButton").addEventListener("click",applyCalibration);
  $("rearmButton").addEventListener("click",rearmCapture);
  $("gen1Apply").addEventListener("click",()=>applyGenerator(1));$("gen2Apply").addEventListener("click",()=>applyGenerator(2));
  $("gen1Duty").addEventListener("input",event=>$("gen1DutyValue").textContent=event.target.value+"%");$("gen2Duty").addEventListener("input",event=>$("gen2DutyValue").textContent=event.target.value+"%");
  $("resetViewButton").addEventListener("click",()=>{$("timebase").value="0";updateVgaTimeControl(false);$("vertical").value="0";updateScaleLabels();$("verticalPosition").value="50";$("triggerMode").value="auto";$("triggerLevel").value="2048";$("triggerPosition").value="1";$("acquisitionAverage").value="0";$("stabilizeWave").checked=false;$("singleShot").checked=false;$("gridEnable").checked=true;$("triggerValue").textContent=formatVolts(2048);$("positionValue").textContent="50%";drawNeeded=true;applyDisplaySettings();});
  let scaleSendTimer=0;
  function scheduleDisplaySettings(){clearTimeout(scaleSendTimer);scaleSendTimer=setTimeout(()=>applyDisplaySettings(),120);}
  $("timebase").addEventListener("input",()=>{updateVgaTimeControl(false);scheduleDisplaySettings();});
  $("timebase").addEventListener("change",()=>{clearTimeout(scaleSendTimer);updateVgaTimeControl(true);});
  $("vertical").addEventListener("input",()=>{updateScaleLabels();drawNeeded=true;scheduleDisplaySettings();});
  $("voltsPerDiv").addEventListener("change",()=>{
    $("vertical").value=$("voltsPerDiv").value;updateScaleLabels();applyDisplaySettings();
  });
  ["vertical","triggerMode","triggerPosition","acquisitionAverage","stabilizeWave","singleShot","gridEnable"].forEach(id=>$(id).addEventListener("change",()=>{clearTimeout(scaleSendTimer);drawNeeded=true;applyDisplaySettings();}));
  $("totalTime").addEventListener("change",()=>{
    $("timebase").value = $("totalTime").value;
    updateVgaTimeControl(true);
  });
  $("totalTime").addEventListener("blur",()=>updateVgaTimeControl(false));
  $("voltsPerDiv").addEventListener("blur",updateScaleLabels);
  $("triggerLevel").addEventListener("input",event=>{$("triggerValue").textContent=formatVolts(Number(event.target.value));drawNeeded=true;});
  $("triggerLevel").addEventListener("change",applyDisplaySettings);
  $("verticalPosition").addEventListener("input",event=>{$("positionValue").textContent=event.target.value+"%";drawNeeded=true;});
  $("verticalPosition").addEventListener("change",applyDisplaySettings);
  window.addEventListener("resize",()=>{drawNeeded=true;drawFft();});
  setInterval(()=>{const now=performance.now(),last=Math.max(lastEventAt,lastLiveFrameAt),age=last?now-last:Infinity;$("ageText").textContent=Number.isFinite(age)?Math.round(age)+" ms":"never";if(connected&&age>2000)setPill($("uartPill"),"bad","FPGA timeout");},500);
  function followHardwareFrame(frame) {
    const changed = manualMode !== frame.manualMode;
    manualMode = frame.manualMode;
    if (!boardFrameKnown || manualMode || changed) {
      clearTimeout(scaleSendTimer);
      document.querySelectorAll(".channel-check").forEach(input=>{
        input.checked=Boolean(frame.mask & (1<<Number(input.value)));
      });
      $("channel").value=String(frame.focus);
      $("timebase").value=String(frame.timebase);
      if (!boardFrameKnown || changed) {
        $("vertical").value=String(frame.scale);
        $("verticalPosition").value=String(frame.position);
        $("gridEnable").checked=frame.grid;
      }
      $("triggerMode").value=["free","rising","falling","auto"][frame.trigger];
      $("triggerPosition").value=String(frame.triggerPosition);
      $("triggerLevel").value=String(frame.triggerLevel);
      $("acquisitionAverage").value=String(frame.averaging);
      $("singleShot").checked=frame.singleShot;
      $("stabilizeWave").checked=frame.stabilize;
      paused=!frame.running;
      $("pauseButton").textContent=paused?"Resume":"Pause";
      $("mobileRunButton").textContent=paused?"Resume":"Pause";
      $("runBadge").textContent=manualMode?"MANUAL":paused?"HOLD":"RUN";
      $("runBadge").classList.toggle("paused",paused);
      $("channelTitle").textContent=enabledChannels().join("/");
      $("enabledLive").textContent=enabledChannels().map(ch=>"CH"+ch).join("/");
      $("positionValue").textContent=frame.position+"%";
      $("triggerValue").textContent=formatVolts(frame.triggerLevel);
      const status=$("commandStatus");status.className="command-status good";
      status.textContent=manualMode
        ? "SW0 manual: all channels live. KEY0 = longer window; KEY1 = shorter."
        : "Phone controls active. SW0 up enables manual mode.";
      ["timebase","totalTime","channel","applyButton","triggerMode","triggerLevel",
        "triggerPosition","acquisitionAverage","stabilizeWave","singleShot",
        "pauseButton","mobileRunButton","autoButton","rearmButton","resetViewButton"]
        .forEach(id=>$(id).disabled=manualMode);
      document.querySelectorAll(".channel-check").forEach(input=>input.disabled=manualMode);
      updateChannelButtons();
    }
    boardFrameKnown=true;
  }
  async function pollLiveFrame() {
    let controller=null, timeout=0;
    try {
      // Waveforms keep updating while EventSource reconnects independently.
      if (!document.hidden && viewMode === "live" && !settingsBusy && !displayBusy) {
        if(typeof AbortController!=="undefined"){
          controller=new AbortController();timeout=setTimeout(()=>controller.abort(),2500);
        }
        const requestedSource=phoneSource;
        const path=`/api/live?raw=${requestedSource==="raw"?1:0}`+(lastFetchedFrameId===null?"":`&after=${lastFetchedFrameId}`);
        const response=await fetch(path,{cache:"no-store",...(controller?{signal:controller.signal}:{})});
        if(response.ok)markConnected();
        if (response.status===200) {
          const frame=CaptureProtocol.decodeLiveFrame(await response.arrayBuffer());
          if(requestedSource!==phoneSource)return;
          lastFetchedFrameId=frame.id;
          followHardwareFrame(frame);
          fullScaleMv=frame.fullScaleMv;measuredSampleCycles=frame.samplePeriodCycles;
          updateScaleLabels();updateVgaTimeControl(false);
          // A frame in transit may precede the latest control change. Keep
          // displaying the last complete window until the new settings arrive.
          if (phoneSource==="snapshot"&&!frame.metadataOnly&&frame.mask===channelMask() && frame.focus===Number($("channel").value) &&
              frame.timebase===Number($("timebase").value) &&
              frame.averaging===Number($("acquisitionAverage").value) &&
              (!liveFrame || frame.id!==liveFrame.id)) {
            liveFrame=frame;lastLiveFrameAt=performance.now();
            fullScaleMv=frame.fullScaleMv;measuredSampleCycles=frame.samplePeriodCycles;
            setPill($("uartPill"),"ok","FPGA streaming");
            clearSamples();
            for(let ch=0;ch<6;ch++)for(const point of frame.traces[ch])
              pushSample(ch,point.adc,point.low,point.high,point.timeMs);
            updateScaleLabels();updateVgaTimeControl(false);drawNeeded=true;
          }
        } else if (response.status!==202 && response.status!==204) throw new Error("Live waveform unavailable. Update both FPGA and Pico firmware.");
        if (liveFrame&&phoneSource==="snapshot") {
          const age=Math.round(performance.now()-lastLiveFrameAt);
          $("measurementSource").textContent=`Live VGA window · ${enabledChannels().length} channels · updated ${age} ms ago`;
        }
      }
    } catch(error) {
      $("measurementSource").textContent=error.message;
      if(!lastNetworkAt||performance.now()-lastNetworkAt>2500){connected=false;setPill($("wifiPill"),"bad","Reconnecting...");}
    } finally {clearTimeout(timeout);setTimeout(pollLiveFrame,phoneSource==="raw"?200:40);}
  }
  function frequencyLabel(hz) {
    return hz>=1000 ? `${Number((hz/1000).toPrecision(4))} kHz` : `${Number(hz.toPrecision(4))} Hz`;
  }
  function drawFft() {
    const canvas=$("fftCanvas"),context=canvas.getContext("2d",{alpha:false});
    const ratio=Math.min(window.devicePixelRatio||1,2),rect=canvas.getBoundingClientRect();
    canvas.width=Math.max(320,Math.round(rect.width*ratio));canvas.height=Math.round(240*ratio);
    context.setTransform(ratio,0,0,ratio,0,0);
    const width=canvas.width/ratio,height=240,left=66,right=width-18,top=22,bottom=height-48;
    context.fillStyle="#050b12";context.fillRect(0,0,width,height);
    context.font="500 12px ui-monospace,monospace";context.fillStyle="#c4d4e5";
    if(!fftSnapshot){context.fillText("Capture FFT to show the spectrum",16,110);return;}
    const maximum=Math.max(0.01,...fftSnapshot.bins.map(bin=>bin.amplitudeVolts))*1.15;
    context.strokeStyle="#193044";context.lineWidth=1;
    const frequencyTicks=width<500?2:4;
    for(let tick=0;tick<=4;tick++) {
      const y=bottom-(bottom-top)*tick/4;
      context.beginPath();context.moveTo(left,y);context.lineTo(right,y);context.stroke();
      context.fillStyle="#c4d4e5";context.textAlign="right";
      context.fillText((maximum*tick/4).toFixed(maximum<0.1?3:2),left-8,y+4);
    }
    for(let tick=0;tick<=frequencyTicks;tick++) {
      const x=left+(right-left)*tick/frequencyTicks;
      context.beginPath();context.moveTo(x,top);context.lineTo(x,bottom);context.stroke();
      context.textAlign=tick===0?"left":tick===frequencyTicks?"right":"center";
      context.fillText(frequencyLabel(fftSnapshot.nyquistHz*tick/frequencyTicks),x,bottom+20);
    }
    context.fillStyle="#c4d4e5";context.textAlign="left";context.fillText("V peak",8,14);
    context.textAlign="center";context.fillText("Frequency",(left+right)/2,height-4);
    context.strokeStyle=TRACE_COLORS[fftSnapshot.focus];context.lineWidth=1.6;
    context.beginPath();fftSnapshot.bins.forEach((bin,index)=>{
      const x=left+(right-left)*index/128,y=bottom-(bottom-top)*bin.amplitudeVolts/maximum;
      if(index===0)context.moveTo(x,y);else context.lineTo(x,y);
    });context.stroke();
    if(fftSnapshot.peak) {
      const peak=fftSnapshot.peak,x=left+(right-left)*peak.frequencyHz/fftSnapshot.nyquistHz;
      context.setLineDash([3,4]);context.strokeStyle="#ffd166";
      context.beginPath();context.moveTo(x,top);context.lineTo(x,bottom);context.stroke();context.setLineDash([]);
      context.fillStyle="#ffd166";context.textAlign="right";
      context.fillText(frequencyLabel(peak.frequencyHz),right,15);
    }
  }
  async function captureFft() {
    if(fftBusy){fftCancelRequested=true;$("fftButton").disabled=true;return;}
    fftBusy=true;fftCancelRequested=false;
    const button=$("fftButton"),status=$("fftStatus");
    button.textContent="Cancel FFT";$("fftRange").disabled=true;
    status.className="command-status";status.textContent="Capturing the focus channel on the FPGA...";
    let id=0,complete=false;
    const request=async path=>{
      const controller=typeof AbortController!=="undefined"?new AbortController():null;
      const timer=controller?setTimeout(()=>controller.abort(),3500):0;
      try {
        const response=await fetch(path,{cache:"no-store",...(controller?{signal:controller.signal}:{})});
        if(!response.ok)throw new Error(await response.text()||`HTTP ${response.status}`);
        return path.startsWith("/api/fft/data") ? await response.arrayBuffer() : await response.json();
      } finally {clearTimeout(timer);}
    };
    try {
      if(settingsBusy||displayBusy)throw new Error("Wait for the current acquisition setting to finish, then capture FFT.");
      const range=$("fftRange").value;
      if(!(measuredSampleCycles>0))throw new Error("Wait for FPGA sampling data before capturing FFT.");
      const sampleRate=50000000/measuredSampleCycles;
      const tb=range==="vga" ? Number($("timebase").value) : range==="raw" ? 0
        : Math.max(0,Math.min(10,Math.ceil(Math.log2(sampleRate/(2*Number(range))))));
      const started=await request(`/api/fft/start?tb=${tb}`);id=started.id;
      const deadline=performance.now()+started.timeoutMs+2000;
      while(performance.now()<deadline) {
        if(fftCancelRequested){await request(`/api/fft/cancel?id=${id}`);id=0;status.textContent="FFT cancelled. The last snapshot is kept.";return;}
        const state=await request(`/api/fft/status?id=${id}`);
        if(state.state==="error"||state.state==="cancelled")throw new Error(state.error||"FFT cancelled.");
        if(state.state==="ready") {
          const snapshot=CaptureProtocol.decodeFftFrame(await request(`/api/fft/data?id=${id}`));
          if(snapshot.id!==id)throw new Error("FFT request changed. Capture again.");
          fftSnapshot=snapshot;complete=true;drawFft();
          const peak=snapshot.peak;
          status.className="command-status good";
          status.textContent=`CH${snapshot.focus} snapshot`+(peak?` · peak ≈ ${frequencyLabel(peak.frequencyHz)} · ${peak.amplitudeVolts.toFixed(3)} V peak`:" · no clear AC peak");
          $("fftDetails").textContent=`${frequencyLabel(snapshot.sampleRateHz)} sample rate · ${frequencyLabel(snapshot.binWidthHz)} per bin · ${snapshot.durationMs.toFixed(2)} ms record · DC ${snapshot.dcVolts.toFixed(3)} V. Hann window; DC removed. Signals above ${frequencyLabel(snapshot.nyquistHz)} alias into this range.`;
          return;
        }
        status.textContent="FPGA capture / FFT in progress. The live scope keeps running.";
        await new Promise(resolve=>setTimeout(resolve,200));
      }
      throw new Error("FFT timed out. Check the FPGA image and capture again.");
    } catch(error) {
      status.className="command-status error";status.textContent=error.message;
    } finally {
      if(id&&!complete)try{await request(`/api/fft/cancel?id=${id}`);}catch{}
      fftBusy=false;button.disabled=false;button.textContent="Capture FPGA FFT";$("fftRange").disabled=false;
    }
  }
  $("fftButton").addEventListener("click",captureFft);
  drawFft();setViewMode("live");pollLiveFrame();
  updateChannelButtons();updateScaleLabels();updateVgaTimeControl(false);resizeCanvas();animationFrame();
})();
</script>

</body>
</html>
)HTML";